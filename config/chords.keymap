#define str(s) #s

#define THCHORD(name, tapMacro, holdMacro) \
  name: name { \
    compatible = "zmk,behavior-hold-tap"; \
    label = str(name); \
    #binding-cells = <2>; \
    tapping_term_ms = <200>; \
    quick_tap_ms = <0>; \
    flavor = "tap-preferred"; \
    bindings = <&holdMacro>, <&tapMacro>; \
  };

#define COMBO(name, keypress, keypos) \
  combo_##name { \
    timeout-ms = <60>; \
    bindings = <keypress>; \
    key-positions = <keypos>; \
  };

#define LAYER_CHORD(name, keypress, keypos, lays) \
  chord_##name { \
    timeout-ms = <60>; \
    bindings = <keypress>; \
    key-positions = <keypos>; \
    layers = <lays>; \
  };

#define CHORD(name, keypress, keypos) \
  LAYER_CHORD(name, keypress, keypos, ALPHA SENTENCE)

#define MACRO(name, keys) \
  name: name##_macro { \
  label = #name; \
  compatible = "zmk,behavior-macro"; \
  #binding-cells = <0>; \
  tap-ms = <1>; \
  wait-ms = <1>; \
  bindings = <keys>; \
  };

#define CHMAC(name, keys) \
  name: name##_macro { \
    label = #name; \
    compatible = "zmk,behavior-macro"; \
    #binding-cells = <0>; \
    tap-ms = <1>; \
    wait-ms = <1>; \
    bindings = <keys>, <&to SENTENCE>; \
  };

#include "personal.keymap"

/ {
  behaviors {
    THCHORD(ht_delete_, ch_delete__t, ch_delete__h)
  };
};

/ {
  combos {
    compatible = "zmk,combos";
    CHORD(ch_delete_, &ht_delete_ 0 0, 31 32)
    CHORD(ch_oneshot, &sl FUNCTION, 30 31 32 33)
    LAYER_CHORD(ch_excl_s, &ch_excl_s, 17 27, SENTENCE)
    LAYER_CHORD(ch_excl, &kp EXCL, 17 27, ALPHA SYMBOL NUMBER)
    LAYER_CHORD(ch_qmark_s, &ch_qmark_s, 18 28, SENTENCE)
    LAYER_CHORD(ch_qmark, &kp QMARK, 18 28, ALPHA SYMBOL NUMBER)
    LAYER_CHORD(ch_colon_s, &ch_colon_s, 19 29, SENTENCE)
    LAYER_CHORD(ch_colon, &kp COLON, 19 29, ALPHA SYMBOL NUMBER)
    LAYER_CHORD(ch_semi_s, &ch_semi_s, 19 9, SENTENCE)
    LAYER_CHORD(ch_semi, &kp SEMI, 19 9, ALPHA SYMBOL NUMBER)
    LAYER_CHORD(ch_interro_s, &ch_interro_s, 17 27 18 28, SENTENCE)
    LAYER_CHORD(ch_interro, &kp QMARK, 17 27 18 28, ALPHA SYMBOL NUMBER)
    LAYER_CHORD(ch_cent, &kp LA(N4), 10 20, SYMBOL)
    LAYER_CHORD(ch_pound, &kp LA(N3), 11 21, SYMBOL)
    LAYER_CHORD(ch_yen, &kp INT_YEN, 12 22, SYMBOL)
    LAYER_CHORD(ch_euro, &kp LA(LS(N2)), 13 23, SYMBOL)
    LAYER_CHORD(ch_mid_ell, &kp QMARK, 14 24, SYMBOL)
    LAYER_CHORD(ch_bullet, &kp LA(N8), 3 13, SYMBOL)
    LAYER_CHORD(ch_degrees, &kp LA(LS(N8)), 2 12, SYMBOL)
    LAYER_CHORD(ch_infinit, &kp LA(N5), 0 10, SYMBOL)
    LAYER_CHORD(ch_lambda, &kp QMARK, 1 11, SYMBOL)
    LAYER_CHORD(ch_command, &kp QMARK, 4 14, SYMBOL)
    LAYER_CHORD(ch_ballot_, &kp QMARK, 15 25, SYMBOL)
    LAYER_CHORD(ch_checkma, &kp QMARK, 16 26, SYMBOL)
    LAYER_CHORD(ch_left_ar, &kp QMARK, 5 15, SYMBOL)
    LAYER_CHORD(ch_down_ar, &kp QMARK, 6 16, SYMBOL)
    LAYER_CHORD(ch_up_arro, &kp QMARK, 7 17, SYMBOL)
    LAYER_CHORD(ch_right_a, &kp QMARK, 8 18, SYMBOL)
    CHORD(ch__ing, &ch__ing, 18 16 14)
    CHORD(ch__n_t, &ch__n_t, 16 9 13)
    CHORD(ch__ve, &ch__ve, 9 22 17)
    CHORD(ch__re, &ch__re, 9 11 17)
    CHORD(ch__s, &ch__s, 9 12 30)
    CHORD(ch__d, &ch__d, 9 23 30)
    CHORD(ch__ll, &ch__ll, 9 1 30)
    CHORD(ch_the, &ch_the, 13 26 17)
    CHORD(ch_S_the, &ch_S_the, 13 26 17 31)
    CHORD(ch_be, &ch_be, 4 17 30)
    CHORD(ch_S_be, &ch_S_be, 4 17 30 31)
    CHORD(ch_of, &ch_of, 7 6 30)
    CHORD(ch_S_of, &ch_S_of, 7 6 30 31)
    CHORD(ch_and, &ch_and, 19 16 23)
    CHORD(ch_S_and, &ch_S_and, 19 16 23 31)
    CHORD(ch_a, &ch_a, 19 30)
    CHORD(ch_S_a, &ch_S_a, 19 30 31)
    CHORD(ch_a1, &ch_a1, 19 31)
    CHORD(ch_to, &ch_to, 13 7 30)
    CHORD(ch_S_to, &ch_S_to, 13 7 30 31)
    CHORD(ch_in, &ch_in, 18 16 30)
    CHORD(ch_S_in, &ch_S_in, 18 16 30 31)
    CHORD(ch_he, &ch_he, 26 17 30)
    CHORD(ch_S_he, &ch_S_he, 26 17 30 31)
    CHORD(ch_have, &ch_have, 26 19 22)
    CHORD(ch_S_have, &ch_S_have, 26 19 22 31)
    CHORD(ch_it, &ch_it, 18 13 30)
    CHORD(ch_S_it, &ch_S_it, 18 13 30 31)
    CHORD(ch_that, &ch_that, 13 26 19)
    CHORD(ch_S_that, &ch_S_that, 13 26 19 31)
    CHORD(ch_for, &ch_for, 6 7 11)
    CHORD(ch_S_for, &ch_S_for, 6 7 11 31)
    CHORD(ch_they, &ch_they, 30 26 2)
    CHORD(ch_S_they, &ch_S_they, 30 26 2 31)
    CHORD(ch_i, &ch_i, 18 30)
    CHORD(ch_with, &ch_with, 0 18 26)
    CHORD(ch_S_with, &ch_S_with, 0 18 26 31)
    CHORD(ch_as, &ch_as, 19 12 30)
    CHORD(ch_S_as, &ch_S_as, 19 12 30 31)
    CHORD(ch_not, &ch_not, 16 7 13)
    CHORD(ch_S_not, &ch_S_not, 16 7 13 31)
    CHORD(ch_on, &ch_on, 7 16 30)
    CHORD(ch_S_on, &ch_S_on, 7 16 30 31)
    CHORD(ch_she, &ch_she, 12 26 17)
    CHORD(ch_S_she, &ch_S_she, 12 26 17 31)
    CHORD(ch_at, &ch_at, 19 13 30)
    CHORD(ch_S_at, &ch_S_at, 19 13 30 31)
    CHORD(ch_by, &ch_by, 4 2 30)
    CHORD(ch_S_by, &ch_S_by, 4 2 30 31)
    CHORD(ch_this, &ch_this, 13 26 12)
    CHORD(ch_S_this, &ch_S_this, 13 26 12 31)
    CHORD(ch_we, &ch_we, 0 17 30)
    CHORD(ch_S_we, &ch_S_we, 0 17 30 31)
    CHORD(ch_you, &ch_you, 2 7 8)
    CHORD(ch_S_you, &ch_S_you, 2 7 8 31)
    CHORD(ch_do, &ch_do, 23 7 30)
    CHORD(ch_S_do, &ch_S_do, 23 7 30 31)
    CHORD(ch_but, &ch_but, 18 8 13)
    CHORD(ch_S_but, &ch_S_but, 18 8 13 31)
    CHORD(ch_from, &ch_from, 30 7 15)
    CHORD(ch_S_from, &ch_S_from, 30 7 15 31)
    CHORD(ch_or, &ch_or, 7 11 30)
    CHORD(ch_S_or, &ch_S_or, 7 11 30 31)
    CHORD(ch_which, &ch_which, 26 18 10)
    CHORD(ch_S_which, &ch_S_which, 26 18 10 31)
    CHORD(ch_one, &ch_one, 7 16 17)
    CHORD(ch_S_one, &ch_S_one, 7 16 17 31)
    CHORD(ch_would, &ch_would, 0 7 8)
    CHORD(ch_S_would, &ch_S_would, 0 7 8 31)
    CHORD(ch_all, &ch_all, 19 1 30)
    CHORD(ch_S_all, &ch_S_all, 19 1 30 31)
    CHORD(ch_will, &ch_will, 0 18 1)
    CHORD(ch_S_will, &ch_S_will, 0 18 1 31)
    CHORD(ch_there, &ch_there, 13 26 11)
    CHORD(ch_S_there, &ch_S_there, 13 26 11 31)
    CHORD(ch_say, &ch_say, 12 19 2)
    CHORD(ch_S_say, &ch_S_say, 12 19 2 31)
    CHORD(ch_who, &ch_who, 16 26 17 27)
    CHORD(ch_S_who, &ch_S_who, 16 26 17 27 31)
    CHORD(ch_make, &ch_make, 15 19 24)
    CHORD(ch_S_make, &ch_S_make, 15 19 24 31)
    CHORD(ch_when, &ch_when, 0 26 17)
    CHORD(ch_S_when, &ch_S_when, 0 26 17 31)
    CHORD(ch_can, &ch_can, 10 19 16)
    CHORD(ch_S_can, &ch_S_can, 10 19 16 31)
    CHORD(ch_more, &ch_more, 15 7 11)
    CHORD(ch_S_more, &ch_S_more, 15 7 11 31)
    CHORD(ch_if, &ch_if, 18 6 30)
    CHORD(ch_S_if, &ch_S_if, 18 6 30 31)
    CHORD(ch_no, &ch_no, 16 17 30)
    CHORD(ch_S_no, &ch_S_no, 16 17 30 31)
    CHORD(ch_man, &ch_man, 15 19 16)
    CHORD(ch_S_man, &ch_S_man, 15 19 16 31)
    CHORD(ch_out, &ch_out, 7 8 13)
    CHORD(ch_S_out, &ch_S_out, 7 8 13 31)
    CHORD(ch_other, &ch_other, 7 13 11)
    CHORD(ch_S_other, &ch_S_other, 7 13 11 31)
    CHORD(ch_so, &ch_so, 12 7 30)
    CHORD(ch_S_so, &ch_S_so, 12 7 30 31)
    CHORD(ch_what, &ch_what, 30 26 19)
    CHORD(ch_S_what, &ch_S_what, 30 26 19 31)
    CHORD(ch_time, &ch_time, 13 15 17)
    CHORD(ch_S_time, &ch_S_time, 13 15 17 31)
    CHORD(ch_up, &ch_up, 8 3 30)
    CHORD(ch_S_up, &ch_S_up, 8 3 30 31)
    CHORD(ch_go, &ch_go, 14 7 30)
    CHORD(ch_S_go, &ch_S_go, 14 7 30 31)
    CHORD(ch_about, &ch_about, 30 8 13)
    CHORD(ch_S_about, &ch_S_about, 30 8 13 31)
    CHORD(ch_than, &ch_than, 13 19 16)
    CHORD(ch_S_than, &ch_S_than, 13 19 16 31)
    CHORD(ch_into, &ch_into, 18 8 30)
    CHORD(ch_S_into, &ch_S_into, 18 8 30 31)
    CHORD(ch_could, &ch_could, 10 7 8)
    CHORD(ch_S_could, &ch_S_could, 10 7 8 31)
    CHORD(ch_state, &ch_state, 12 13 19)
    CHORD(ch_S_state, &ch_S_state, 12 13 19 31)
    CHORD(ch_only, &ch_only, 7 1 2)
    CHORD(ch_S_only, &ch_S_only, 7 1 2 31)
    CHORD(ch_new, &ch_new, 16 17 0)
    CHORD(ch_S_new, &ch_S_new, 16 17 0 31)
    CHORD(ch_year, &ch_year, 2 17 19)
    CHORD(ch_S_year, &ch_S_year, 2 17 19 31)
    CHORD(ch_some, &ch_some, 12 7 15)
    CHORD(ch_S_some, &ch_S_some, 12 7 15 31)
    CHORD(ch_take, &ch_take, 19 24 17)
    CHORD(ch_S_take, &ch_S_take, 19 24 17 31)
    CHORD(ch_come, &ch_come, 10 7 15)
    CHORD(ch_S_come, &ch_S_come, 10 7 15 31)
    CHORD(ch_these, &ch_these, 16 26 12)
    CHORD(ch_S_these, &ch_S_these, 16 26 12 31)
    CHORD(ch_know, &ch_know, 24 16 7)
    CHORD(ch_S_know, &ch_S_know, 24 16 7 31)
    CHORD(ch_see, &ch_see, 12 17 30)
    CHORD(ch_S_see, &ch_S_see, 12 17 30 31)
    CHORD(ch_use, &ch_use, 8 12 17)
    CHORD(ch_S_use, &ch_S_use, 8 12 17 31)
    CHORD(ch_get, &ch_get, 14 17 13)
    CHORD(ch_S_get, &ch_S_get, 14 17 13 31)
    CHORD(ch_like, &ch_like, 18 17 30)
    CHORD(ch_S_like, &ch_S_like, 18 17 30 31)
    CHORD(ch_then, &ch_then, 13 17 16)
    CHORD(ch_S_then, &ch_S_then, 13 17 16 31)
    CHORD(ch_first, &ch_first, 6 11 12)
    CHORD(ch_S_first, &ch_S_first, 6 11 12 31)
    CHORD(ch_any, &ch_any, 19 16 2)
    CHORD(ch_S_any, &ch_S_any, 19 16 2 31)
    CHORD(ch_work, &ch_work, 7 11 24)
    CHORD(ch_S_work, &ch_S_work, 7 11 24 31)
    CHORD(ch_now, &ch_now, 16 7 0)
    CHORD(ch_S_now, &ch_S_now, 16 7 0 31)
    CHORD(ch_may, &ch_may, 15 19 2)
    CHORD(ch_S_may, &ch_S_may, 15 19 2 31)
    CHORD(ch_such, &ch_such, 12 10 26)
    CHORD(ch_S_such, &ch_S_such, 12 10 26 31)
    CHORD(ch_give, &ch_give, 30 14 17)
    CHORD(ch_S_give, &ch_S_give, 30 14 17 31)
    CHORD(ch_over, &ch_over, 7 22 11)
    CHORD(ch_S_over, &ch_S_over, 7 22 11 31)
    CHORD(ch_think, &ch_think, 26 18 24)
    CHORD(ch_S_think, &ch_S_think, 26 18 24 31)
    CHORD(ch_most, &ch_most, 15 7 13)
    CHORD(ch_S_most, &ch_S_most, 15 7 13 31)
    CHORD(ch_even, &ch_even, 17 22 16)
    CHORD(ch_S_even, &ch_S_even, 17 22 16 31)
    CHORD(ch_find, &ch_find, 30 6 16)
    CHORD(ch_S_find, &ch_S_find, 30 6 16 31)
    CHORD(ch_day, &ch_day, 19 2 30)
    CHORD(ch_S_day, &ch_S_day, 19 2 30 31)
    CHORD(ch_also, &ch_also, 19 1 7)
    CHORD(ch_S_also, &ch_S_also, 19 1 7 31)
    CHORD(ch_after, &ch_after, 6 13 11)
    CHORD(ch_S_after, &ch_S_after, 6 13 11 31)
    CHORD(ch_way, &ch_way, 0 19 10)
    CHORD(ch_S_way, &ch_S_way, 0 19 10 31)
    CHORD(ch_many, &ch_many, 15 16 2)
    CHORD(ch_S_many, &ch_S_many, 15 16 2 31)
    CHORD(ch_must, &ch_must, 15 8 13)
    CHORD(ch_S_must, &ch_S_must, 15 8 13 31)
    CHORD(ch_look, &ch_look, 1 7 24)
    CHORD(ch_S_look, &ch_S_look, 1 7 24 31)
    CHORD(ch_before, &ch_before, 4 6 7)
    CHORD(ch_S_before, &ch_S_before, 4 6 7 31)
    CHORD(ch_great, &ch_great, 14 11 17)
    CHORD(ch_S_great, &ch_S_great, 14 11 17 31)
    CHORD(ch_back, &ch_back, 4 19 10)
    CHORD(ch_S_back, &ch_S_back, 4 19 10 31)
    CHORD(ch_through, &ch_through, 26 11 14)
    CHORD(ch_S_through, &ch_S_through, 26 11 14 31)
    CHORD(ch_long, &ch_long, 1 7 16)
    CHORD(ch_S_long, &ch_S_long, 1 7 16 31)
    CHORD(ch_where, &ch_where, 30 17 11)
    CHORD(ch_S_where, &ch_S_where, 30 17 11 31)
    CHORD(ch_much, &ch_much, 15 8 10)
    CHORD(ch_S_much, &ch_S_much, 15 8 10 31)
    CHORD(ch_should, &ch_should, 12 7 8)
    CHORD(ch_S_should, &ch_S_should, 12 7 8 31)
    CHORD(ch_well, &ch_well, 0 17 1)
    CHORD(ch_S_well, &ch_S_well, 0 17 1 31)
    CHORD(ch_people, &ch_people, 3 17 1)
    CHORD(ch_S_people, &ch_S_people, 3 17 1 31)
    CHORD(ch_down, &ch_down, 30 23 16)
    CHORD(ch_S_down, &ch_S_down, 30 23 16 31)
    CHORD(ch_own, &ch_own, 30 0 16)
    CHORD(ch_S_own, &ch_S_own, 30 0 16 31)
    CHORD(ch_just, &ch_just, 8 12 13)
    CHORD(ch_S_just, &ch_S_just, 8 12 13 31)
    CHORD(ch_because, &ch_because, 4 17 19)
    CHORD(ch_S_because, &ch_S_because, 4 17 19 31)
    CHORD(ch_good, &ch_good, 22 7 23)
    CHORD(ch_S_good, &ch_S_good, 22 7 23 31)
    CHORD(ch_each, &ch_each, 19 10 26)
    CHORD(ch_S_each, &ch_S_each, 19 10 26 31)
    CHORD(ch_those, &ch_those, 13 7 12)
    CHORD(ch_S_those, &ch_S_those, 13 7 12 31)
    CHORD(ch_feel, &ch_feel, 6 17 1)
    CHORD(ch_S_feel, &ch_S_feel, 6 17 1 31)
    CHORD(ch_seem, &ch_seem, 12 17 15)
    CHORD(ch_S_seem, &ch_S_seem, 12 17 15 31)
    CHORD(ch_how, &ch_how, 26 16 30)
    CHORD(ch_S_how, &ch_S_how, 26 16 30 31)
    CHORD(ch_high, &ch_high, 26 18 14)
    CHORD(ch_S_high, &ch_S_high, 26 18 14 31)
    CHORD(ch_too, &ch_too, 13 7 6)
    CHORD(ch_S_too, &ch_S_too, 13 7 6 31)
    CHORD(ch_place, &ch_place, 3 10 17)
    CHORD(ch_S_place, &ch_S_place, 3 10 17 31)
    CHORD(ch_little, &ch_little, 1 18 13)
    CHORD(ch_S_little, &ch_S_little, 1 18 13 31)
    CHORD(ch_world, &ch_world, 7 11 1)
    CHORD(ch_S_world, &ch_S_world, 7 11 1 31)
    CHORD(ch_very, &ch_very, 22 17 11)
    CHORD(ch_S_very, &ch_S_very, 22 17 11 31)
    CHORD(ch_still, &ch_still, 12 13 1)
    CHORD(ch_S_still, &ch_S_still, 12 13 1 31)
    CHORD(ch_nation, &ch_nation, 19 13 18)
    CHORD(ch_S_nation, &ch_S_nation, 19 13 18 31)
    CHORD(ch_hand, &ch_hand, 26 16 23)
    CHORD(ch_S_hand, &ch_S_hand, 26 16 23 31)
    CHORD(ch_old, &ch_old, 30 7 1)
    CHORD(ch_S_old, &ch_S_old, 30 7 1 31)
    CHORD(ch_life, &ch_life, 1 18 6)
    CHORD(ch_S_life, &ch_S_life, 1 18 6 31)
    CHORD(ch_tell, &ch_tell, 13 17 1)
    CHORD(ch_S_tell, &ch_S_tell, 13 17 1 31)
    CHORD(ch_write, &ch_write, 11 18 17)
    CHORD(ch_S_write, &ch_S_write, 11 18 17 31)
    CHORD(ch_become, &ch_become, 10 15 17)
    CHORD(ch_S_become, &ch_S_become, 10 15 17 31)
    CHORD(ch_here, &ch_here, 26 11 30)
    CHORD(ch_S_here, &ch_S_here, 26 11 30 31)
    CHORD(ch_show, &ch_show, 12 26 30)
    CHORD(ch_S_show, &ch_S_show, 12 26 30 31)
    CHORD(ch_house, &ch_house, 7 12 17)
    CHORD(ch_S_house, &ch_S_house, 7 12 17 31)
    CHORD(ch_both, &ch_both, 30 13 26)
    CHORD(ch_S_both, &ch_S_both, 30 13 26 31)
    CHORD(ch_between, &ch_between, 4 17 16)
    CHORD(ch_S_between, &ch_S_between, 4 17 16 31)
    CHORD(ch_need, &ch_need, 13 16 23)
    CHORD(ch_S_need, &ch_S_need, 13 16 23 31)
    CHORD(ch_mean, &ch_mean, 15 16 30)
    CHORD(ch_S_mean, &ch_S_mean, 15 16 30 31)
    CHORD(ch_call, &ch_call, 30 10 19)
    CHORD(ch_S_call, &ch_S_call, 30 10 19 31)
    CHORD(ch_develop, &ch_develop, 23 17 22)
    CHORD(ch_S_develop, &ch_S_develop, 23 17 22 31)
    CHORD(ch_under, &ch_under, 8 16 23)
    CHORD(ch_S_under, &ch_S_under, 8 16 23 31)
    CHORD(ch_last, &ch_last, 1 19 12)
    CHORD(ch_S_last, &ch_S_last, 1 19 12 31)
    CHORD(ch_right, &ch_right, 11 18 13)
    CHORD(ch_S_right, &ch_S_right, 11 18 13 31)
    CHORD(ch_move, &ch_move, 15 22 17)
    CHORD(ch_S_move, &ch_S_move, 15 22 17 31)
    CHORD(ch_thing, &ch_thing, 13 18 16)
    CHORD(ch_S_thing, &ch_S_thing, 13 18 16 31)
    CHORD(ch_general, &ch_general, 14 17 16)
    CHORD(ch_S_general, &ch_S_general, 14 17 16 31)
    CHORD(ch_school, &ch_school, 12 26 1)
    CHORD(ch_S_school, &ch_S_school, 12 26 1 31)
    CHORD(ch_never, &ch_never, 16 22 11)
    CHORD(ch_S_never, &ch_S_never, 16 22 11 31)
    CHORD(ch_same, &ch_same, 12 19 15)
    CHORD(ch_S_same, &ch_S_same, 12 19 15 31)
    CHORD(ch_another, &ch_another, 19 26 11)
    CHORD(ch_S_another, &ch_S_another, 19 26 11 31)
    CHORD(ch_begin, &ch_begin, 17 14 18)
    CHORD(ch_S_begin, &ch_S_begin, 17 14 18 31)
    CHORD(ch_while, &ch_while, 26 18 17)
    CHORD(ch_S_while, &ch_S_while, 26 18 17 31)
    CHORD(ch_number, &ch_number, 16 17 11)
    CHORD(ch_S_number, &ch_S_number, 16 17 11 31)
    CHORD(ch_part, &ch_part, 3 19 11)
    CHORD(ch_S_part, &ch_S_part, 3 19 11 31)
    CHORD(ch_turn, &ch_turn, 13 8 16)
    CHORD(ch_S_turn, &ch_S_turn, 13 8 16 31)
    CHORD(ch_real, &ch_real, 17 19 1)
    CHORD(ch_S_real, &ch_S_real, 17 19 1 31)
    CHORD(ch_leave, &ch_leave, 17 19 22)
    CHORD(ch_S_leave, &ch_S_leave, 17 19 22 31)
    CHORD(ch_might, &ch_might, 15 18 13)
    CHORD(ch_S_might, &ch_S_might, 15 18 13 31)
    CHORD(ch_want, &ch_want, 0 19 13)
    CHORD(ch_S_want, &ch_S_want, 0 19 13 31)
    CHORD(ch_point, &ch_point, 3 7 18)
    CHORD(ch_S_point, &ch_S_point, 3 7 18 31)
    CHORD(ch_form, &ch_form, 6 11 30)
    CHORD(ch_S_form, &ch_S_form, 6 11 30 31)
    CHORD(ch_off, &ch_off, 7 6 16 17)
    CHORD(ch_S_off, &ch_S_off, 7 6 16 17 31)
    CHORD(ch_child, &ch_child, 10 18 23)
    CHORD(ch_S_child, &ch_S_child, 10 18 23 31)
    CHORD(ch_few, &ch_few, 6 17 0)
    CHORD(ch_S_few, &ch_S_few, 6 17 0 31)
    CHORD(ch_small, &ch_small, 15 19 1)
    CHORD(ch_S_small, &ch_S_small, 15 19 1 31)
    CHORD(ch_since, &ch_since, 12 18 17)
    CHORD(ch_S_since, &ch_S_since, 12 18 17 31)
    CHORD(ch_against, &ch_against, 19 14 16)
    CHORD(ch_S_against, &ch_S_against, 19 14 16 31)
    CHORD(ch_ask, &ch_ask, 19 12 24)
    CHORD(ch_S_ask, &ch_S_ask, 19 12 24 31)
    CHORD(ch_late, &ch_late, 1 19 13)
    CHORD(ch_S_late, &ch_S_late, 1 19 13 31)
    CHORD(ch_home, &ch_home, 30 7 17)
    CHORD(ch_S_home, &ch_S_home, 30 7 17 31)
    CHORD(ch_interes, &ch_interes, 18 16 11)
    CHORD(ch_S_interes, &ch_S_interes, 18 16 11 31)
    CHORD(ch_large, &ch_large, 19 11 14)
    CHORD(ch_S_large, &ch_S_large, 19 11 14 31)
    CHORD(ch_person, &ch_person, 3 12 16)
    CHORD(ch_S_person, &ch_S_person, 3 12 16 31)
    CHORD(ch_end, &ch_end, 17 16 23)
    CHORD(ch_S_end, &ch_S_end, 17 16 23 31)
    CHORD(ch_open, &ch_open, 7 3 16)
    CHORD(ch_S_open, &ch_S_open, 7 3 16 31)
    CHORD(ch_public, &ch_public, 3 1 18)
    CHORD(ch_S_public, &ch_S_public, 3 1 18 31)
    CHORD(ch_follow, &ch_follow, 6 7 1)
    CHORD(ch_S_follow, &ch_S_follow, 6 7 1 31)
    CHORD(ch_during, &ch_during, 23 11 16)
    CHORD(ch_S_during, &ch_S_during, 23 11 16 31)
    CHORD(ch_present, &ch_present, 11 16 13)
    CHORD(ch_S_present, &ch_S_present, 11 16 13 31)
    CHORD(ch_without, &ch_without, 18 13 7)
    CHORD(ch_S_without, &ch_S_without, 18 13 7 31)
    CHORD(ch_again, &ch_again, 19 14 18)
    CHORD(ch_S_again, &ch_S_again, 19 14 18 31)
    CHORD(ch_hold, &ch_hold, 26 23 30)
    CHORD(ch_S_hold, &ch_S_hold, 26 23 30 31)
    CHORD(ch_govern, &ch_govern, 14 11 16)
    CHORD(ch_S_govern, &ch_S_govern, 14 11 16 31)
    CHORD(ch_around, &ch_around, 19 11 23)
    CHORD(ch_S_around, &ch_S_around, 19 11 23 31)
    CHORD(ch_possibl, &ch_possibl, 3 12 17)
    CHORD(ch_S_possibl, &ch_S_possibl, 3 12 17 31)
    CHORD(ch_head, &ch_head, 26 17 23)
    CHORD(ch_S_head, &ch_S_head, 26 17 23 31)
    CHORD(ch_conside, &ch_conside, 10 16 23)
    CHORD(ch_S_conside, &ch_S_conside, 10 16 23 31)
    CHORD(ch_word, &ch_word, 30 11 23)
    CHORD(ch_S_word, &ch_S_word, 30 11 23 31)
    CHORD(ch_program, &ch_program, 11 14 15)
    CHORD(ch_S_program, &ch_S_program, 11 14 15 31)
    CHORD(ch_problem, &ch_problem, 1 17 15)
    CHORD(ch_S_problem, &ch_S_problem, 1 17 15 31)
    CHORD(ch_however, &ch_however, 26 17 22)
    CHORD(ch_S_however, &ch_S_however, 26 17 22 31)
    CHORD(ch_lead, &ch_lead, 17 19 23)
    CHORD(ch_S_lead, &ch_S_lead, 17 19 23 31)
    CHORD(ch_system, &ch_system, 12 2 13)
    CHORD(ch_S_system, &ch_S_system, 12 2 13 31)
    CHORD(ch_set, &ch_set, 12 17 13)
    CHORD(ch_S_set, &ch_S_set, 12 17 13 31)
    CHORD(ch_order, &ch_order, 7 11 23)
    CHORD(ch_S_order, &ch_S_order, 7 11 23 31)
    CHORD(ch_eye, &ch_eye, 17 2 30)
    CHORD(ch_S_eye, &ch_S_eye, 17 2 30 31)
    CHORD(ch_plan, &ch_plan, 3 1 16)
    CHORD(ch_S_plan, &ch_S_plan, 3 1 16 31)
    CHORD(ch_run, &ch_run, 11 8 16)
    CHORD(ch_S_run, &ch_S_run, 11 8 16 31)
    CHORD(ch_keep, &ch_keep, 17 3 30)
    CHORD(ch_S_keep, &ch_S_keep, 17 3 30 31)
    CHORD(ch_face, &ch_face, 6 19 10)
    CHORD(ch_S_face, &ch_S_face, 6 19 10 31)
    CHORD(ch_fact, &ch_fact, 6 10 13)
    CHORD(ch_S_fact, &ch_S_fact, 6 10 13 31)
    CHORD(ch_group, &ch_group, 14 7 8)
    CHORD(ch_S_group, &ch_S_group, 14 7 8 31)
    CHORD(ch_play, &ch_play, 3 1 2)
    CHORD(ch_S_play, &ch_S_play, 3 1 2 31)
    CHORD(ch_stand, &ch_stand, 12 16 23)
    CHORD(ch_S_stand, &ch_S_stand, 12 16 23 31)
    CHORD(ch_increas, &ch_increas, 18 16 10)
    CHORD(ch_S_increas, &ch_S_increas, 18 16 10 31)
    CHORD(ch_early, &ch_early, 17 1 2)
    CHORD(ch_S_early, &ch_S_early, 17 1 2 31)
    CHORD(ch_course, &ch_course, 7 11 12)
    CHORD(ch_S_course, &ch_S_course, 7 11 12 31)
    CHORD(ch_change, &ch_change, 10 26 17)
    CHORD(ch_S_change, &ch_S_change, 10 26 17 31)
    CHORD(ch_help, &ch_help, 26 1 3)
    CHORD(ch_S_help, &ch_S_help, 26 1 3 31)
    CHORD(ch_line, &ch_line, 1 16 17)
    CHORD(ch_S_line, &ch_S_line, 1 16 17 31)
    CHORD(ch_his, &ch_his, 26 18 12)
    CHORD(ch_S_his, &ch_S_his, 26 18 12 31)
    CHORD(ch_her, &ch_her, 26 17 11)
    CHORD(ch_S_her, &ch_S_her, 26 17 11 31)
    CHORD(ch_an, &ch_an, 19 16 30)
    CHORD(ch_S_an, &ch_S_an, 19 16 30 31)
    CHORD(ch_my, &ch_my, 15 2 30)
    CHORD(ch_S_my, &ch_S_my, 15 2 30 31)
    CHORD(ch_their, &ch_their, 26 18 11)
    CHORD(ch_S_their, &ch_S_their, 26 18 11 31)
    CHORD(ch_me, &ch_me, 15 17 30)
    CHORD(ch_S_me, &ch_S_me, 15 17 30 31)
    CHORD(ch_him, &ch_him, 4 18 15)
    CHORD(ch_S_him, &ch_S_him, 4 18 15 31)
    CHORD(ch_your, &ch_your, 2 7 11)
    CHORD(ch_S_your, &ch_S_your, 2 7 11 31)
    CHORD(ch_them, &ch_them, 26 15 16 25)
    CHORD(ch_S_them, &ch_S_them, 26 15 16 25 31)
    CHORD(ch_its, &ch_its, 18 13 12)
    CHORD(ch_S_its, &ch_S_its, 18 13 12 31)
    CHORD(ch_two, &ch_two, 13 0 7)
    CHORD(ch_S_two, &ch_S_two, 13 0 7 31)
    CHORD(ch_our, &ch_our, 7 8 11)
    CHORD(ch_S_our, &ch_S_our, 7 8 11 31)
    CHORD(ch_us, &ch_us, 8 12 30)
    CHORD(ch_S_us, &ch_S_us, 8 12 30 31)
    CHORD(ch_is, &ch_is, 18 12 30)
    CHORD(ch_S_is, &ch_S_is, 18 12 30 31)
    CHORD(ch_was, &ch_was, 0 19 12)
    CHORD(ch_S_was, &ch_S_was, 0 19 12 31)
    CHORD(ch_are, &ch_are, 19 11 17)
    CHORD(ch_S_are, &ch_S_are, 19 11 17 31)
    CHORD(ch_had, &ch_had, 26 19 23)
    CHORD(ch_S_had, &ch_S_had, 26 19 23 31)
    CHORD(ch_were, &ch_were, 0 17 11)
    CHORD(ch_S_were, &ch_S_were, 0 17 11 31)
    CHORD(ch_said, &ch_said, 12 19 18)
    CHORD(ch_S_said, &ch_S_said, 12 19 18 31)
    CHORD(ch_has, &ch_has, 26 19 12)
    CHORD(ch_S_has, &ch_S_has, 26 19 12 31)
    CHORD(ch_did, &ch_did, 23 18 30)
    CHORD(ch_S_did, &ch_S_did, 23 18 30 31)
    CHORD(ch_sound, &ch_sound, 12 8 23)
    CHORD(ch_S_sound, &ch_S_sound, 12 8 23 31)
    CHORD(ch_water, &ch_water, 0 13 11)
    CHORD(ch_S_water, &ch_S_water, 0 13 11 31)
    CHORD(ch_side, &ch_side, 12 18 23)
    CHORD(ch_S_side, &ch_S_side, 12 18 23 31)
    CHORD(ch_been, &ch_been, 4 16 30)
    CHORD(ch_S_been, &ch_S_been, 4 16 30 31)
    CHORD(ch_made, &ch_made, 15 23 17)
    CHORD(ch_S_made, &ch_S_made, 15 23 17 31)
    CHORD(ch_live, &ch_live, 1 18 22)
    CHORD(ch_S_live, &ch_S_live, 1 18 22 31)
    CHORD(ch_round, &ch_round, 7 8 23)
    CHORD(ch_S_round, &ch_S_round, 7 8 23 31)
    CHORD(ch_came, &ch_came, 10 19 15)
    CHORD(ch_S_came, &ch_S_came, 10 19 15 31)
    CHORD(ch_every, &ch_every, 17 11 2)
    CHORD(ch_S_every, &ch_S_every, 17 11 2 31)
    CHORD(ch_name, &ch_name, 16 19 17)
    CHORD(ch_S_name, &ch_S_name, 16 19 17 31)
    CHORD(ch_sentenc, &ch_sentenc, 12 17 16)
    CHORD(ch_S_sentenc, &ch_S_sentenc, 12 17 16 31)
    CHORD(ch_low, &ch_low, 1 7 0)
    CHORD(ch_S_low, &ch_S_low, 1 7 0 31)
    CHORD(ch_differ, &ch_differ, 23 6 11)
    CHORD(ch_S_differ, &ch_S_differ, 23 6 11 31)
    CHORD(ch_cause, &ch_cause, 10 19 12)
    CHORD(ch_S_cause, &ch_S_cause, 10 19 12 31)
    CHORD(ch_boy, &ch_boy, 4 7 2)
    CHORD(ch_S_boy, &ch_S_boy, 4 7 2 31)
    CHORD(ch_does, &ch_does, 23 17 12)
    CHORD(ch_S_does, &ch_S_does, 23 17 12 31)
    CHORD(ch_three, &ch_three, 13 17 30)
    CHORD(ch_S_three, &ch_S_three, 13 17 30 31)
    CHORD(ch_air, &ch_air, 19 18 11)
    CHORD(ch_S_air, &ch_S_air, 19 18 11 31)
    CHORD(ch_put, &ch_put, 3 8 13)
    CHORD(ch_S_put, &ch_S_put, 3 8 13 31)
    CHORD(ch_read, &ch_read, 11 19 30)
    CHORD(ch_S_read, &ch_S_read, 11 19 30 31)
    CHORD(ch_port, &ch_port, 3 7 11)
    CHORD(ch_S_port, &ch_S_port, 3 7 11 31)
    CHORD(ch_spell, &ch_spell, 12 3 1)
    CHORD(ch_S_spell, &ch_S_spell, 12 3 1 31)
    CHORD(ch_add, &ch_add, 19 23 30)
    CHORD(ch_S_add, &ch_S_add, 19 23 30 31)
    CHORD(ch_land, &ch_land, 1 16 23)
    CHORD(ch_S_land, &ch_S_land, 1 16 23 31)
    CHORD(ch_big, &ch_big, 4 18 14)
    CHORD(ch_S_big, &ch_S_big, 4 18 14 31)
    CHORD(ch_act, &ch_act, 19 10 13)
    CHORD(ch_S_act, &ch_S_act, 19 10 13 31)
    CHORD(ch_why, &ch_why, 0 26 2)
    CHORD(ch_S_why, &ch_S_why, 0 26 2 31)
    CHORD(ch_men, &ch_men, 15 17 16)
    CHORD(ch_S_men, &ch_S_men, 15 17 16 31)
    CHORD(ch_went, &ch_went, 0 16 13)
    CHORD(ch_S_went, &ch_S_went, 0 16 13 31)
    CHORD(ch_light, &ch_light, 1 18 14)
    CHORD(ch_S_light, &ch_S_light, 1 18 14 31)
    CHORD(ch_kind, &ch_kind, 18 16 23)
    CHORD(ch_S_kind, &ch_S_kind, 18 16 23 31)
    CHORD(ch_picture, &ch_picture, 3 18 10)
    CHORD(ch_S_picture, &ch_S_picture, 3 18 10 31)
    CHORD(ch_try, &ch_try, 13 11 2)
    CHORD(ch_S_try, &ch_S_try, 13 11 2 31)
    CHORD(ch_animal, &ch_animal, 19 16 1)
    CHORD(ch_S_animal, &ch_S_animal, 19 16 1 31)
    CHORD(ch_mother, &ch_mother, 15 13 11)
    CHORD(ch_S_mother, &ch_S_mother, 15 13 11 31)
    CHORD(ch_near, &ch_near, 16 11 30)
    CHORD(ch_S_near, &ch_S_near, 16 11 30 31)
    CHORD(ch_build, &ch_build, 4 8 1)
    CHORD(ch_S_build, &ch_S_build, 4 8 1 31)
    CHORD(ch_self, &ch_self, 12 1 6)
    CHORD(ch_S_self, &ch_S_self, 12 1 6 31)
    CHORD(ch_earth, &ch_earth, 17 19 26)
    CHORD(ch_S_earth, &ch_S_earth, 17 19 26 31)
    CHORD(ch_father, &ch_father, 6 19 17)
    CHORD(ch_S_father, &ch_S_father, 6 19 17 31)
    CHORD(ch_page, &ch_page, 3 19 17)
    CHORD(ch_S_page, &ch_S_page, 3 19 17 31)
    CHORD(ch_country, &ch_country, 10 8 2)
    CHORD(ch_S_country, &ch_S_country, 10 8 2 31)
    CHORD(ch_found, &ch_found, 6 8 23)
    CHORD(ch_S_found, &ch_S_found, 6 8 23 31)
    CHORD(ch_answer, &ch_answer, 19 16 12)
    CHORD(ch_S_answer, &ch_S_answer, 19 16 12 31)
    CHORD(ch_grow, &ch_grow, 14 11 0)
    CHORD(ch_S_grow, &ch_S_grow, 14 11 0 31)
    CHORD(ch_study, &ch_study, 13 8 2)
    CHORD(ch_S_study, &ch_S_study, 13 8 2 31)
    CHORD(ch_learn, &ch_learn, 1 17 11)
    CHORD(ch_S_learn, &ch_S_learn, 1 17 11 31)
    CHORD(ch_plant, &ch_plant, 3 1 13)
    CHORD(ch_S_plant, &ch_S_plant, 3 1 13 31)
    CHORD(ch_cover, &ch_cover, 10 7 22)
    CHORD(ch_S_cover, &ch_S_cover, 10 7 22 31)
    CHORD(ch_food, &ch_food, 6 7 23)
    CHORD(ch_S_food, &ch_S_food, 6 7 23 31)
    CHORD(ch_sun, &ch_sun, 12 8 16)
    CHORD(ch_S_sun, &ch_S_sun, 12 8 16 31)
    CHORD(ch_four, &ch_four, 6 7 8)
    CHORD(ch_S_four, &ch_S_four, 6 7 8 31)
    CHORD(ch_let, &ch_let, 1 17 30)
    CHORD(ch_S_let, &ch_S_let, 1 17 30 31)
    CHORD(ch_thought, &ch_thought, 13 26 8)
    CHORD(ch_S_thought, &ch_S_thought, 13 26 8 31)
    CHORD(ch_city, &ch_city, 10 13 2)
    CHORD(ch_S_city, &ch_S_city, 10 13 2 31)
    CHORD(ch_tree, &ch_tree, 13 11 30)
    CHORD(ch_S_tree, &ch_S_tree, 13 11 30 31)
    CHORD(ch_cross, &ch_cross, 10 11 12)
    CHORD(ch_S_cross, &ch_S_cross, 10 11 12 31)
    CHORD(ch_farm, &ch_farm, 11 15 30)
    CHORD(ch_S_farm, &ch_S_farm, 11 15 30 31)
    CHORD(ch_hard, &ch_hard, 26 11 23)
    CHORD(ch_S_hard, &ch_S_hard, 26 11 23 31)
    CHORD(ch_start, &ch_start, 12 11 30)
    CHORD(ch_S_start, &ch_S_start, 12 11 30 31)
    CHORD(ch_story, &ch_story, 7 2 30)
    CHORD(ch_S_story, &ch_S_story, 7 2 30 31)
    CHORD(ch_far, &ch_far, 6 19 11)
    CHORD(ch_S_far, &ch_S_far, 6 19 11 31)
    CHORD(ch_sea, &ch_sea, 12 17 19)
    CHORD(ch_S_sea, &ch_S_sea, 12 17 19 31)
    CHORD(ch_draw, &ch_draw, 23 19 0)
    CHORD(ch_S_draw, &ch_S_draw, 23 19 0 31)
    CHORD(ch_left, &ch_left, 1 6 13)
    CHORD(ch_S_left, &ch_S_left, 1 6 13 31)
    CHORD(ch_press, &ch_press, 3 11 12)
    CHORD(ch_S_press, &ch_S_press, 3 11 12 31)
    CHORD(ch_close, &ch_close, 10 7 12)
    CHORD(ch_S_close, &ch_S_close, 10 7 12 31)
    CHORD(ch_night, &ch_night, 16 14 26)
    CHORD(ch_S_night, &ch_S_night, 16 14 26 31)
    CHORD(ch_north, &ch_north, 16 11 26)
    CHORD(ch_S_north, &ch_S_north, 16 11 26 31)
    CHORD(ch_togethe, &ch_togethe, 7 14 26)
    CHORD(ch_S_togethe, &ch_S_togethe, 7 14 26 31)
    CHORD(ch_next, &ch_next, 17 25 13)
    CHORD(ch_S_next, &ch_S_next, 17 25 13 31)
    CHORD(ch_white, &ch_white, 0 18 17)
    CHORD(ch_S_white, &ch_S_white, 0 18 17 31)
    CHORD(ch_childre, &ch_childre, 26 18 23)
    CHORD(ch_S_childre, &ch_S_childre, 26 18 23 31)
    CHORD(ch_got, &ch_got, 14 7 13)
    CHORD(ch_S_got, &ch_S_got, 14 7 13 31)
    CHORD(ch_walk, &ch_walk, 0 19 30)
    CHORD(ch_S_walk, &ch_S_walk, 0 19 30 31)
    CHORD(ch_example, &ch_example, 15 3 1)
    CHORD(ch_S_example, &ch_S_example, 15 3 1 31)
    CHORD(ch_paper, &ch_paper, 3 19 30)
    CHORD(ch_S_paper, &ch_S_paper, 3 19 30 31)
    CHORD(ch_always, &ch_always, 1 0 2)
    CHORD(ch_S_always, &ch_S_always, 1 0 2 31)
    CHORD(ch_music, &ch_music, 15 12 10)
    CHORD(ch_S_music, &ch_S_music, 15 12 10 31)
    CHORD(ch_mark, &ch_mark, 15 11 24)
    CHORD(ch_S_mark, &ch_S_mark, 15 11 24 31)
    CHORD(ch_often, &ch_often, 7 13 17)
    CHORD(ch_S_often, &ch_S_often, 7 13 17 31)
    CHORD(ch_letter, &ch_letter, 1 13 11)
    CHORD(ch_S_letter, &ch_S_letter, 1 13 11 31)
    CHORD(ch_until, &ch_until, 16 13 1)
    CHORD(ch_S_until, &ch_S_until, 16 13 1 31)
    CHORD(ch_mile, &ch_mile, 15 18 17)
    CHORD(ch_S_mile, &ch_S_mile, 15 18 17 31)
    CHORD(ch_river, &ch_river, 11 18 22)
    CHORD(ch_S_river, &ch_S_river, 11 18 22 31)
    CHORD(ch_car, &ch_car, 10 19 11)
    CHORD(ch_S_car, &ch_S_car, 10 19 11 31)
    CHORD(ch_feet, &ch_feet, 6 17 13)
    CHORD(ch_S_feet, &ch_S_feet, 6 17 13 31)
    CHORD(ch_care, &ch_care, 10 11 17)
    CHORD(ch_S_care, &ch_S_care, 10 11 17 31)
    CHORD(ch_second, &ch_second, 12 17 10)
    CHORD(ch_S_second, &ch_S_second, 12 17 10 31)
    CHORD(ch_book, &ch_book, 4 7 30)
    CHORD(ch_S_book, &ch_S_book, 4 7 30 31)
    CHORD(ch_carry, &ch_carry, 10 19 2)
    CHORD(ch_S_carry, &ch_S_carry, 10 19 2 31)
    CHORD(ch_science, &ch_science, 12 10 18)
    CHORD(ch_S_science, &ch_S_science, 12 10 18 31)
    CHORD(ch_eat, &ch_eat, 17 19 13)
    CHORD(ch_S_eat, &ch_S_eat, 17 19 13 31)
    CHORD(ch_friend, &ch_friend, 11 18 23)
    CHORD(ch_S_friend, &ch_S_friend, 11 18 23 31)
    CHORD(ch_began, &ch_began, 4 14 16)
    CHORD(ch_S_began, &ch_S_began, 4 14 16 31)
    CHORD(ch_idea, &ch_idea, 18 23 19)
    CHORD(ch_S_idea, &ch_S_idea, 18 23 19 31)
    CHORD(ch_fish, &ch_fish, 6 18 12)
    CHORD(ch_S_fish, &ch_S_fish, 6 18 12 31)
    CHORD(ch_mountai, &ch_mountai, 7 19 13)
    CHORD(ch_S_mountai, &ch_S_mountai, 7 19 13 31)
    CHORD(ch_stop, &ch_stop, 12 13 3)
    CHORD(ch_S_stop, &ch_S_stop, 12 13 3 31)
    CHORD(ch_once, &ch_once, 16 10 17)
    CHORD(ch_S_once, &ch_S_once, 16 10 17 31)
    CHORD(ch_base, &ch_base, 4 19 12)
    CHORD(ch_S_base, &ch_S_base, 4 19 12 31)
    CHORD(ch_horse, &ch_horse, 26 11 12)
    CHORD(ch_S_horse, &ch_S_horse, 26 11 12 31)
    CHORD(ch_cut, &ch_cut, 10 8 13)
    CHORD(ch_S_cut, &ch_S_cut, 10 8 13 31)
    CHORD(ch_sure, &ch_sure, 12 8 11)
    CHORD(ch_S_sure, &ch_S_sure, 12 8 11 31)
    CHORD(ch_watch, &ch_watch, 0 19 26)
    CHORD(ch_S_watch, &ch_S_watch, 0 19 26 31)
    CHORD(ch_color, &ch_color, 10 7 11)
    CHORD(ch_S_color, &ch_S_color, 10 7 11 31)
    CHORD(ch_wood, &ch_wood, 0 7 23)
    CHORD(ch_S_wood, &ch_S_wood, 0 7 23 31)
    CHORD(ch_main, &ch_main, 15 18 16)
    CHORD(ch_S_main, &ch_S_main, 15 18 16 31)
    CHORD(ch_enough, &ch_enough, 16 7 14)
    CHORD(ch_S_enough, &ch_S_enough, 16 7 14 31)
    CHORD(ch_plain, &ch_plain, 3 19 18)
    CHORD(ch_S_plain, &ch_S_plain, 3 19 18 31)
    CHORD(ch_girl, &ch_girl, 14 18 11)
    CHORD(ch_S_girl, &ch_S_girl, 14 18 11 31)
    CHORD(ch_usual, &ch_usual, 8 12 1)
    CHORD(ch_S_usual, &ch_S_usual, 8 12 1 31)
    CHORD(ch_young, &ch_young, 2 7 14)
    CHORD(ch_S_young, &ch_S_young, 2 7 14 31)
    CHORD(ch_ready, &ch_ready, 17 23 2)
    CHORD(ch_S_ready, &ch_S_ready, 17 23 2 31)
    CHORD(ch_above, &ch_above, 19 4 22)
    CHORD(ch_S_above, &ch_S_above, 19 4 22 31)
    CHORD(ch_ever, &ch_ever, 17 22 30)
    CHORD(ch_S_ever, &ch_S_ever, 17 22 30 31)
    CHORD(ch_red, &ch_red, 11 17 23)
    CHORD(ch_S_red, &ch_S_red, 11 17 23 31)
    CHORD(ch_list, &ch_list, 1 18 12)
    CHORD(ch_S_list, &ch_S_list, 1 18 12 31)
    CHORD(ch_though, &ch_though, 26 8 14)
    CHORD(ch_S_though, &ch_S_though, 26 8 14 31)
    CHORD(ch_bird, &ch_bird, 4 18 11)
    CHORD(ch_S_bird, &ch_S_bird, 4 18 11 31)
    CHORD(ch_soon, &ch_soon, 12 16 30)
    CHORD(ch_S_soon, &ch_S_soon, 12 16 30 31)
    CHORD(ch_body, &ch_body, 7 23 2)
    CHORD(ch_S_body, &ch_S_body, 7 23 2 31)
    CHORD(ch_family, &ch_family, 6 19 2)
    CHORD(ch_S_family, &ch_S_family, 6 19 2 31)
    CHORD(ch_direct, &ch_direct, 23 11 10)
    CHORD(ch_S_direct, &ch_S_direct, 23 11 10 31)
    CHORD(ch_pose, &ch_pose, 3 7 12)
    CHORD(ch_S_pose, &ch_S_pose, 3 7 12 31)
    CHORD(ch_song, &ch_song, 12 16 14)
    CHORD(ch_S_song, &ch_S_song, 12 16 14 31)
    CHORD(ch_measure, &ch_measure, 19 12 8)
    CHORD(ch_S_measure, &ch_S_measure, 19 12 8 31)
    CHORD(ch_product, &ch_product, 11 23 8)
    CHORD(ch_S_product, &ch_S_product, 11 23 8 31)
    CHORD(ch_black, &ch_black, 4 1 10)
    CHORD(ch_S_black, &ch_S_black, 4 1 10 31)
    CHORD(ch_short, &ch_short, 26 7 11)
    CHORD(ch_S_short, &ch_S_short, 26 7 11 31)
    CHORD(ch_numeral, &ch_numeral, 8 15 19)
    CHORD(ch_S_numeral, &ch_S_numeral, 8 15 19 31)
    CHORD(ch_class, &ch_class, 10 1 12)
    CHORD(ch_S_class, &ch_S_class, 10 1 12 31)
    CHORD(ch_wind, &ch_wind, 0 18 23)
    CHORD(ch_S_wind, &ch_S_wind, 0 18 23 31)
    CHORD(ch_questio, &ch_questio, 20 17 16)
    CHORD(ch_S_questio, &ch_S_questio, 20 17 16 31)
    CHORD(ch_happen, &ch_happen, 26 19 3)
    CHORD(ch_S_happen, &ch_S_happen, 26 19 3 31)
    CHORD(ch_complet, &ch_complet, 10 15 13)
    CHORD(ch_S_complet, &ch_S_complet, 10 15 13 31)
    CHORD(ch_ship, &ch_ship, 12 26 3)
    CHORD(ch_S_ship, &ch_S_ship, 12 26 3 31)
    CHORD(ch_half, &ch_half, 26 19 1)
    CHORD(ch_S_half, &ch_S_half, 26 19 1 31)
    CHORD(ch_rock, &ch_rock, 11 10 24)
    CHORD(ch_S_rock, &ch_S_rock, 11 10 24 31)
    CHORD(ch_fire, &ch_fire, 6 18 11)
    CHORD(ch_S_fire, &ch_S_fire, 6 18 11 31)
    CHORD(ch_south, &ch_south, 12 8 26)
    CHORD(ch_S_south, &ch_S_south, 12 8 26 31)
    CHORD(ch_piece, &ch_piece, 3 18 17)
    CHORD(ch_S_piece, &ch_S_piece, 3 18 17 31)
    CHORD(ch_told, &ch_told, 13 1 23)
    CHORD(ch_S_told, &ch_S_told, 13 1 23 31)
    CHORD(ch_knew, &ch_knew, 24 16 17)
    CHORD(ch_S_knew, &ch_S_knew, 24 16 17 31)
    CHORD(ch_pass, &ch_pass, 3 19 12)
    CHORD(ch_S_pass, &ch_S_pass, 3 19 12 31)
    CHORD(ch_top, &ch_top, 13 7 3)
    CHORD(ch_S_top, &ch_S_top, 13 7 3 31)
    CHORD(ch_whole, &ch_whole, 0 26 1)
    CHORD(ch_S_whole, &ch_S_whole, 0 26 1 31)
    CHORD(ch_king, &ch_king, 24 18 16)
    CHORD(ch_S_king, &ch_S_king, 24 18 16 31)
    CHORD(ch_space, &ch_space, 12 3 10)
    CHORD(ch_S_space, &ch_S_space, 12 3 10 31)
    CHORD(ch_heard, &ch_heard, 17 23 30)
    CHORD(ch_S_heard, &ch_S_heard, 17 23 30 31)
    CHORD(ch_best, &ch_best, 4 17 12)
    CHORD(ch_S_best, &ch_S_best, 4 17 12 31)
    CHORD(ch_hour, &ch_hour, 26 8 11)
    CHORD(ch_S_hour, &ch_S_hour, 26 8 11 31)
    CHORD(ch_better, &ch_better, 4 17 11)
    CHORD(ch_S_better, &ch_S_better, 4 17 11 31)
    CHORD(ch_true, &ch_true, 13 11 8)
    CHORD(ch_S_true, &ch_S_true, 13 11 8 31)
    CHORD(ch_hundred, &ch_hundred, 26 8 17)
    CHORD(ch_S_hundred, &ch_S_hundred, 26 8 17 31)
    CHORD(ch_five, &ch_five, 6 18 22)
    CHORD(ch_S_five, &ch_S_five, 6 18 22 31)
    CHORD(ch_remembe, &ch_remembe, 11 17 15)
    CHORD(ch_S_remembe, &ch_S_remembe, 11 17 15 31)
    CHORD(ch_fast, &ch_fast, 6 12 13)
    CHORD(ch_S_fast, &ch_S_fast, 6 12 13 31)
    CHORD(ch_listen, &ch_listen, 1 12 16)
    CHORD(ch_S_listen, &ch_S_listen, 1 12 16 31)
    CHORD(ch_six, &ch_six, 12 18 25)
    CHORD(ch_S_six, &ch_S_six, 12 18 25 31)
    CHORD(ch_war, &ch_war, 0 19 11)
    CHORD(ch_S_war, &ch_S_war, 0 19 11 31)
    CHORD(ch_lay, &ch_lay, 1 19 2)
    CHORD(ch_S_lay, &ch_S_lay, 1 19 2 31)
    CHORD(ch_pattern, &ch_pattern, 3 17 16)
    CHORD(ch_S_pattern, &ch_S_pattern, 3 17 16 31)
    CHORD(ch_center, &ch_center, 10 13 11)
    CHORD(ch_S_center, &ch_S_center, 10 13 11 31)
    CHORD(ch_love, &ch_love, 7 22 17)
    CHORD(ch_S_love, &ch_S_love, 7 22 17 31)
    CHORD(ch_map, &ch_map, 15 19 3)
    CHORD(ch_S_map, &ch_S_map, 15 19 3 31)
    CHORD(ch_power, &ch_power, 7 0 17)
    CHORD(ch_S_power, &ch_S_power, 7 0 17 31)
    CHORD(ch_fly, &ch_fly, 6 1 2)
    CHORD(ch_S_fly, &ch_S_fly, 6 1 2 31)
    CHORD(ch_fall, &ch_fall, 6 19 1)
    CHORD(ch_S_fall, &ch_S_fall, 6 19 1 31)
    CHORD(ch_cry, &ch_cry, 10 11 2)
    CHORD(ch_S_cry, &ch_S_cry, 10 11 2 31)
    CHORD(ch_machine, &ch_machine, 10 26 16)
    CHORD(ch_S_machine, &ch_S_machine, 10 26 16 31)
    CHORD(ch_box, &ch_box, 4 7 25)
    CHORD(ch_S_box, &ch_S_box, 4 7 25 31)
    CHORD(ch_noun, &ch_noun, 16 7 8)
    CHORD(ch_S_noun, &ch_S_noun, 16 7 8 31)
    CHORD(ch_field, &ch_field, 6 18 23)
    CHORD(ch_S_field, &ch_S_field, 6 18 23 31)
    CHORD(ch_contain, &ch_contain, 10 13 30)
    CHORD(ch_S_contain, &ch_S_contain, 10 13 30 31)
    CHORD(ch_week, &ch_week, 0 17 24)
    CHORD(ch_S_week, &ch_S_week, 0 17 24 31)
    CHORD(ch_final, &ch_final, 6 18 16)
    CHORD(ch_S_final, &ch_S_final, 6 18 16 31)
    CHORD(ch_oh, &ch_oh, 7 26 30)
    CHORD(ch_S_oh, &ch_S_oh, 7 26 30 31)
    CHORD(ch_quick, &ch_quick, 20 18 10)
    CHORD(ch_S_quick, &ch_S_quick, 20 18 10 31)
    CHORD(ch_free, &ch_free, 6 11 17)
    CHORD(ch_S_free, &ch_S_free, 6 11 17 31)
    CHORD(ch_object, &ch_object, 7 4 17)
    CHORD(ch_S_object, &ch_S_object, 7 4 17 31)
    CHORD(ch_test, &ch_test, 13 12 30)
    CHORD(ch_S_test, &ch_S_test, 13 12 30 31)
    CHORD(ch_dry, &ch_dry, 23 11 2)
    CHORD(ch_S_dry, &ch_S_dry, 23 11 2 31)
    CHORD(ch_ago, &ch_ago, 19 14 7)
    CHORD(ch_S_ago, &ch_S_ago, 19 14 7 31)
    CHORD(ch_ran, &ch_ran, 11 19 16)
    CHORD(ch_S_ran, &ch_S_ran, 11 19 16 31)
    CHORD(ch_hot, &ch_hot, 26 7 13)
    CHORD(ch_S_hot, &ch_S_hot, 26 7 13 31)
    CHORD(ch_ball, &ch_ball, 4 19 1)
    CHORD(ch_S_ball, &ch_S_ball, 4 19 1 31)
    CHORD(ch_yet, &ch_yet, 2 17 13)
    CHORD(ch_S_yet, &ch_S_yet, 2 17 13 31)
    CHORD(ch_am, &ch_am, 19 15 30)
    CHORD(ch_S_am, &ch_S_am, 19 15 30 31)
    CHORD(ch_arm, &ch_arm, 19 11 15)
    CHORD(ch_S_arm, &ch_S_arm, 19 11 15 31)
    CHORD(ch_ice, &ch_ice, 18 10 17)
    CHORD(ch_S_ice, &ch_S_ice, 18 10 17 31)
    CHORD(ch_matter, &ch_matter, 15 19 13)
    CHORD(ch_S_matter, &ch_S_matter, 15 19 13 31)
    CHORD(ch_count, &ch_count, 10 7 16)
    CHORD(ch_S_count, &ch_S_count, 10 7 16 31)
    CHORD(ch_length, &ch_length, 1 16 14)
    CHORD(ch_S_length, &ch_S_length, 1 16 14 31)
    CHORD(ch_art, &ch_art, 19 11 13)
    CHORD(ch_S_art, &ch_S_art, 19 11 13 31)
    CHORD(ch_cell, &ch_cell, 10 17 1)
    CHORD(ch_S_cell, &ch_S_cell, 10 17 1 31)
    CHORD(ch_summer, &ch_summer, 12 15 11)
    CHORD(ch_S_summer, &ch_S_summer, 12 15 11 31)
    CHORD(ch_leg, &ch_leg, 1 17 14)
    CHORD(ch_S_leg, &ch_S_leg, 1 17 14 31)
    CHORD(ch_catch, &ch_catch, 10 13 26)
    CHORD(ch_S_catch, &ch_S_catch, 10 13 26 31)
    CHORD(ch_joy, &ch_joy, 21 7 2)
    CHORD(ch_S_joy, &ch_S_joy, 21 7 2 31)
    CHORD(ch_job, &ch_job, 21 7 4)
    CHORD(ch_S_job, &ch_S_job, 21 7 4 31)
    CHORD(ch_gas, &ch_gas, 14 19 12)
    CHORD(ch_S_gas, &ch_S_gas, 14 19 12 31)
    CHORD(ch_buy, &ch_buy, 4 8 2)
    CHORD(ch_S_buy, &ch_S_buy, 4 8 2 31)
    CHORD(ch_cook, &ch_cook, 10 7 24)
    CHORD(ch_S_cook, &ch_S_cook, 10 7 24 31)
    CHORD(ch_hill, &ch_hill, 26 18 1)
    CHORD(ch_S_hill, &ch_S_hill, 26 18 1 31)
    CHORD(ch_type, &ch_type, 13 3 17)
    CHORD(ch_S_type, &ch_S_type, 13 3 17 31)
    CHORD(ch_law, &ch_law, 1 19 0)
    CHORD(ch_S_law, &ch_S_law, 1 19 0 31)
    CHORD(ch_bit, &ch_bit, 4 18 30)
    CHORD(ch_S_bit, &ch_S_bit, 4 18 30 31)
    CHORD(ch_copy, &ch_copy, 7 3 2)
    CHORD(ch_S_copy, &ch_S_copy, 7 3 2 31)
    CHORD(ch_lie, &ch_lie, 1 18 17)
    CHORD(ch_S_lie, &ch_S_lie, 1 18 17 31)
    CHORD(ch_else, &ch_else, 17 1 12)
    CHORD(ch_S_else, &ch_S_else, 17 1 12 31)
    CHORD(ch_case, &ch_case, 10 17 30)
    CHORD(ch_S_case, &ch_S_case, 10 17 30 31)
    CHORD(ch_son, &ch_son, 12 7 16)
    CHORD(ch_S_son, &ch_S_son, 12 7 16 31)
    CHORD(ch_method, &ch_method, 15 13 30)
    CHORD(ch_S_method, &ch_S_method, 15 13 30 31)
    CHORD(ch_pay, &ch_pay, 3 19 2)
    CHORD(ch_S_pay, &ch_S_pay, 3 19 2 31)
    CHORD(ch_age, &ch_age, 19 14 17)
    CHORD(ch_S_age, &ch_S_age, 19 14 17 31)
    CHORD(ch_cool, &ch_cool, 10 7 1)
    CHORD(ch_S_cool, &ch_S_cool, 10 7 1 31)
    CHORD(ch_design, &ch_design, 17 12 14)
    CHORD(ch_S_design, &ch_S_design, 17 12 14 31)
    CHORD(ch_lot, &ch_lot, 1 7 13)
    CHORD(ch_S_lot, &ch_S_lot, 1 7 13 31)
    CHORD(ch_key, &ch_key, 24 17 2)
    CHORD(ch_S_key, &ch_S_key, 24 17 2 31)
    CHORD(ch_office, &ch_office, 6 7 16 17 10)
    CHORD(ch_S_office, &ch_S_office, 6 7 16 17 10 31)
    CHORD(ch_row, &ch_row, 11 7 0)
    CHORD(ch_S_row, &ch_S_row, 11 7 0 31)
    CHORD(ch_die, &ch_die, 23 18 17)
    CHORD(ch_S_die, &ch_S_die, 23 18 17 31)
    CHORD(ch_break, &ch_break, 11 17 24)
    CHORD(ch_S_break, &ch_S_break, 11 17 24 31)
    CHORD(ch_oil, &ch_oil, 7 18 1)
    CHORD(ch_S_oil, &ch_S_oil, 7 18 1 31)
    CHORD(ch_team, &ch_team, 17 19 30)
    CHORD(ch_S_team, &ch_S_team, 17 19 30 31)
    CHORD(ch_fit, &ch_fit, 6 18 13)
    CHORD(ch_S_fit, &ch_S_fit, 6 18 13 31)
    CHORD(ch_charact, &ch_charact, 10 26 11)
    CHORD(ch_S_charact, &ch_S_charact, 10 26 11 31)
    CHORD(ch_element, &ch_element, 1 15 13)
    CHORD(ch_S_element, &ch_S_element, 1 15 13 31)
    CHORD(ch_hit, &ch_hit, 26 18 13)
    CHORD(ch_S_hit, &ch_S_hit, 26 18 13 31)
    CHORD(ch_string, &ch_string, 12 11 16)
    CHORD(ch_S_string, &ch_S_string, 12 11 16 31)
    CHORD(ch_rub, &ch_rub, 11 8 4)
    CHORD(ch_S_rub, &ch_S_rub, 11 8 4 31)
    CHORD(ch_tie, &ch_tie, 13 18 17)
    CHORD(ch_S_tie, &ch_S_tie, 13 18 17 31)
    CHORD(ch_search, &ch_search, 12 17 11)
    CHORD(ch_S_search, &ch_S_search, 12 17 11 31)
    CHORD(ch_gun, &ch_gun, 14 8 16)
    CHORD(ch_S_gun, &ch_S_gun, 14 8 16 31)
    CHORD(ch_print, &ch_print, 3 18 16)
    CHORD(ch_S_print, &ch_S_print, 3 18 16 31)
    CHORD(ch_continu, &ch_continu, 10 16 13)
    CHORD(ch_S_continu, &ch_S_continu, 10 16 13 31)
    CHORD(ch_nine, &ch_nine, 16 18 17)
    CHORD(ch_S_nine, &ch_S_nine, 16 18 17 31)
    CHORD(ch_throw, &ch_throw, 30 7 0)
    CHORD(ch_S_throw, &ch_S_throw, 30 7 0 31)
    CHORD(ch_select, &ch_select, 17 10 13)
    CHORD(ch_S_select, &ch_S_select, 17 10 13 31)
    CHORD(ch_thank, &ch_thank, 26 19 24)
    CHORD(ch_S_thank, &ch_S_thank, 26 19 24 31)
    CHORD(ch_branch, &ch_branch, 4 16 26)
    CHORD(ch_S_branch, &ch_S_branch, 4 16 26 31)
    CHORD(ch_match, &ch_match, 15 10 30)
    CHORD(ch_S_match, &ch_S_match, 15 10 30 31)
    CHORD(ch_experie, &ch_experie, 17 25 3)
    CHORD(ch_S_experie, &ch_S_experie, 17 25 3 31)
    CHORD(ch_led, &ch_led, 1 17 23)
    CHORD(ch_S_led, &ch_S_led, 1 17 23 31)
    CHORD(ch_win, &ch_win, 0 18 16)
    CHORD(ch_S_win, &ch_S_win, 0 18 16 31)
    CHORD(ch_conditi, &ch_conditi, 10 23 13)
    CHORD(ch_S_conditi, &ch_S_conditi, 10 23 13 31)
    CHORD(ch_feed, &ch_feed, 6 17 23)
    CHORD(ch_S_feed, &ch_S_feed, 6 17 23 31)
    CHORD(ch_nor, &ch_nor, 16 7 11)
    CHORD(ch_S_nor, &ch_S_nor, 16 7 11 31)
    CHORD(ch_double, &ch_double, 7 8 4)
    CHORD(ch_S_double, &ch_S_double, 7 8 4 31)
    CHORD(ch_master, &ch_master, 15 12 13)
    CHORD(ch_S_master, &ch_S_master, 15 12 13 31)
    CHORD(ch_post, &ch_post, 3 7 12 13)
    CHORD(ch_S_post, &ch_S_post, 3 7 12 13 31)
    CHORD(ch_chord, &ch_chord, 10 26 23)
    CHORD(ch_S_chord, &ch_S_chord, 10 26 23 31)
    CHORD(ch_fat, &ch_fat, 6 19 13)
    CHORD(ch_S_fat, &ch_S_fat, 6 19 13 31)
    CHORD(ch_bar, &ch_bar, 4 19 11)
    CHORD(ch_S_bar, &ch_S_bar, 4 19 11 31)
    CHORD(ch_enemy, &ch_enemy, 17 16 2)
    CHORD(ch_S_enemy, &ch_S_enemy, 17 16 2 31)
    CHORD(ch_support, &ch_support, 12 8 3)
    CHORD(ch_S_support, &ch_S_support, 12 8 3 31)
    CHORD(ch_range, &ch_range, 11 19 16 14)
    CHORD(ch_S_range, &ch_S_range, 11 19 16 14 31)
    CHORD(ch_log, &ch_log, 1 7 14)
    CHORD(ch_S_log, &ch_S_log, 1 7 14 31)
    CHORD(ch_hey, &ch_hey, 26 17 2)
    CHORD(ch_S_hey, &ch_S_hey, 26 17 2 31)
    CHORD(ch_yep, &ch_yep, 2 17 3)
    CHORD(ch_S_yep, &ch_S_yep, 2 17 3 31)
    CHORD(ch_probabl, &ch_probabl, 3 4 1 2)
    CHORD(ch_S_probabl, &ch_S_probabl, 3 4 1 2 31)
    CHORD(ch_thanks, &ch_thanks, 13 16 12)
    CHORD(ch_S_thanks, &ch_S_thanks, 13 16 12 31)
    CHORD(ch_i_ve, &ch_i_ve, 18 22 17)
    CHORD(ch_per, &ch_per, 3 17 11)
    CHORD(ch_S_per, &ch_S_per, 3 17 11 31)
    CHORD(ch_acknowl, &ch_acknowl, 19 10 24)
    CHORD(ch_S_acknowl, &ch_S_acknowl, 19 10 24 31)
    CHORD(ch_attack, &ch_attack, 19 24 30)
    CHORD(ch_S_attack, &ch_S_attack, 19 24 30 31)
    CHORD(ch_defend, &ch_defend, 17 6 16)
    CHORD(ch_S_defend, &ch_S_defend, 17 6 16 31)
    CHORD(ch_expansi, &ch_expansi, 17 3 7)
    CHORD(ch_S_expansi, &ch_S_expansi, 17 3 7 31)
    CHORD(ch_fuck, &ch_fuck, 6 8 10)
    CHORD(ch_S_fuck, &ch_S_fuck, 6 8 10 31)
    CHORD(ch_hell, &ch_hell, 26 17 1 30)
    CHORD(ch_S_hell, &ch_S_hell, 26 17 1 30 31)
    CHORD(ch_heck, &ch_heck, 26 17 24)
    CHORD(ch_S_heck, &ch_S_heck, 26 17 24 31)
    CHORD(ch_shit, &ch_shit, 12 26 18 13)
    CHORD(ch_S_shit, &ch_S_shit, 12 26 18 13 31)
    CHORD(ch_persona, &ch_persona, 3 12 7 16)
    CHORD(ch_S_persona, &ch_S_persona, 3 12 7 16 31)
    CHORD(ch_i_m, &ch_i_m, 18 15 30)
    CHORD(ch_i_ll, &ch_i_ll, 18 1 30)
    CHORD(ch_in_the, &ch_in_the, 18 16 13 17)
    CHORD(ch_S_in_the, &ch_S_in_the, 18 16 13 17 31)
    CHORD(ch_of_the, &ch_of_the, 7 13 17 30)
    CHORD(ch_S_of_the, &ch_S_of_the, 7 13 17 30 31)
    CHORD(ch_to_be, &ch_to_be, 7 4 17 30)
    CHORD(ch_S_to_be, &ch_S_to_be, 7 4 17 30 31)
    CHORD(ch_to_the, &ch_to_the, 13 26 17 30)
    CHORD(ch_S_to_the, &ch_S_to_the, 13 26 17 30 31)
    CHORD(ch_and_the, &ch_and_the, 19 16 13 26)
    CHORD(ch_S_and_the, &ch_S_and_the, 19 16 13 26 31)
    CHORD(ch_and_i, &ch_and_i, 19 16 23 18)
    CHORD(ch_S_and_i, &ch_S_and_i, 19 16 23 18 31)
    CHORD(ch_on_the, &ch_on_the, 7 16 26 17)
    CHORD(ch_S_on_the, &ch_S_on_the, 7 16 26 17 31)
    CHORD(ch_it_is, &ch_it_is, 18 13 12 30)
    CHORD(ch_S_it_is, &ch_S_it_is, 18 13 12 30 31)
    CHORD(ch_if_you, &ch_if_you, 6 2 7 8)
    CHORD(ch_S_if_you, &ch_S_if_you, 6 2 7 8 31)
    CHORD(ch_the_wor, &ch_the_wor, 13 26 17 0)
    CHORD(ch_S_the_wor, &ch_S_the_wor, 13 26 17 0 31)
    CHORD(ch_in_a, &ch_in_a, 18 16 19 30)
    CHORD(ch_S_in_a, &ch_S_in_a, 18 16 19 30 31)
    CHORD(ch_of_cour, &ch_of_cour, 7 6 10)
    CHORD(ch_S_of_cour, &ch_S_of_cour, 7 6 10 31)
    CHORD(ch_admin, &ch_admin, 23 15 16)
    CHORD(ch_S_admin, &ch_S_admin, 23 15 16 31)
    CHORD(ch_array, &ch_array, 19 11 2)
    CHORD(ch_S_array, &ch_S_array, 19 11 2 31)
    CHORD(ch_async, &ch_async, 12 2 16)
    CHORD(ch_S_async, &ch_S_async, 12 2 16 31)
    CHORD(ch_await, &ch_await, 19 18 13 30)
    CHORD(ch_S_await, &ch_S_await, 19 18 13 30 31)
    CHORD(ch_define, &ch_define, 23 6 16)
    CHORD(ch_S_define, &ch_S_define, 23 6 16 31)
    CHORD(ch_div, &ch_div, 23 18 22)
    CHORD(ch_S_div, &ch_S_div, 23 18 22 31)
    CHORD(ch_environ, &ch_environ, 17 22 13)
    CHORD(ch_S_environ, &ch_S_environ, 17 22 13 31)
    CHORD(ch_git, &ch_git, 14 18 13)
    CHORD(ch_S_git, &ch_S_git, 14 18 13 31)
    CHORD(ch_graphql, &ch_graphql, 14 19 26 1)
    CHORD(ch_S_graphql, &ch_S_graphql, 14 19 26 1 31)
    CHORD(ch_https_, &ch_https_, 26 13 3)
    CHORD(ch_immutab, &ch_immutab, 18 15 4 1)
    CHORD(ch_S_immutab, &ch_S_immutab, 18 15 4 1 31)
    CHORD(ch_impleme, &ch_impleme, 18 15 3)
    CHORD(ch_S_impleme, &ch_S_impleme, 18 15 3 31)
    CHORD(ch_import, &ch_import, 18 15 11)
    CHORD(ch_S_import, &ch_S_import, 18 15 11 31)
    CHORD(ch_infra, &ch_infra, 16 6 11)
    CHORD(ch_S_infra, &ch_S_infra, 16 6 11 31)
    CHORD(ch_insert, &ch_insert, 18 16 12)
    CHORD(ch_S_insert, &ch_S_insert, 18 16 12 31)
    CHORD(ch_insert_, &ch_insert_, 18 16 12 30)
    CHORD(ch_S_insert_, &ch_S_insert_, 18 16 12 30 31)
    CHORD(ch_int, &ch_int, 18 16 13 30)
    CHORD(ch_S_int, &ch_S_int, 18 16 13 30 31)
    CHORD(ch_interfa, &ch_interfa, 18 10 6)
    CHORD(ch_S_interfa, &ch_S_interfa, 18 10 6 31)
    CHORD(ch_json, &ch_json, 21 12 16)
    CHORD(ch_S_json, &ch_S_json, 21 12 16 31)
    CHORD(ch_kuberne, &ch_kuberne, 24 17 16 12)
    CHORD(ch_S_kuberne, &ch_S_kuberne, 24 17 16 12 31)
    CHORD(ch_library, &ch_library, 1 18 4)
    CHORD(ch_S_library, &ch_S_library, 1 18 4 31)
    CHORD(ch_module, &ch_module, 15 7 23)
    CHORD(ch_S_module, &ch_S_module, 15 7 23 31)
    CHORD(ch_nil, &ch_nil, 16 18 1)
    CHORD(ch_S_nil, &ch_S_nil, 16 18 1 31)
    CHORD(ch_null, &ch_null, 16 8 1)
    CHORD(ch_S_null, &ch_S_null, 16 8 1 31)
    CHORD(ch_project, &ch_project, 7 21 17)
    CHORD(ch_S_project, &ch_S_project, 7 21 17 31)
    CHORD(ch_pub, &ch_pub, 3 8 4)
    CHORD(ch_S_pub, &ch_S_pub, 3 8 4 31)
    CHORD(ch_regex, &ch_regex, 11 14 25)
    CHORD(ch_S_regex, &ch_S_regex, 11 14 25 31)
    CHORD(ch_return, &ch_return, 11 17 13)
    CHORD(ch_S_return, &ch_S_return, 11 17 13 31)
    CHORD(ch_schema, &ch_schema, 10 17 19)
    CHORD(ch_S_schema, &ch_S_schema, 10 17 19 31)
    CHORD(ch_select_, &ch_select_, 12 13 6 11)
    CHORD(ch_S_select_, &ch_S_select_, 12 13 6 11 31)
    CHORD(ch_server, &ch_server, 12 11 22)
    CHORD(ch_S_server, &ch_S_server, 12 11 22 31)
    CHORD(ch_service, &ch_service, 12 22 18)
    CHORD(ch_S_service, &ch_S_service, 12 22 18 31)
    CHORD(ch_sort, &ch_sort, 12 11 13)
    CHORD(ch_S_sort, &ch_S_sort, 12 11 13 31)
    CHORD(ch_sudo, &ch_sudo, 7 8 17 18)
    CHORD(ch_S_sudo, &ch_S_sudo, 7 8 17 18 31)
    CHORD(ch_tempora, &ch_tempora, 13 17 15 3)
    CHORD(ch_S_tempora, &ch_S_tempora, 13 17 15 3 31)
    CHORD(ch_trait, &ch_trait, 13 11 19 18)
    CHORD(ch_S_trait, &ch_S_trait, 13 11 19 18 31)
    CHORD(ch_queue, &ch_queue, 20 8 17)
    CHORD(ch_S_queue, &ch_S_queue, 20 8 17 31)
    CHORD(ch_quote, &ch_quote, 20 8 7)
    CHORD(ch_S_quote, &ch_S_quote, 20 8 7 31)
    CHORD(ch_undefin, &ch_undefin, 8 16 6)
    CHORD(ch_S_undefin, &ch_S_undefin, 8 16 6 31)
    CHORD(ch__up_, &ch__up_, 10 7 23 17)
    CHORD(ch__typesc, &ch__typesc, 13 12 7 17)
    CHORD(ch__go_up_, &ch__go_up_, 14 1 7 17)
    CHORD(ch_the_qui, &ch_the_qui, 4 20 25 9)
    CHORD(ch_S_the_qui, &ch_S_the_qui, 4 20 25 9 31)
    CHORD(ch_elberet, &ch_elberet, 17 1 4 26)
    CHORD(ch_pokemon, &ch_pokemon, 3 7 15 16)
    CHORD(ch_S_pokemon, &ch_S_pokemon, 3 7 15 16 31)
    CHORD(ch_final_f, &ch_final_f, 6 18 16 30)
    CHORD(ch_S_final_f, &ch_S_final_f, 6 18 16 30 31)
  };
};

/ {
  macros {
    MACRO(ch_delete__t, &kp LA(BSPC))
    MACRO(ch_delete__h, &sk LG(LA(LCTRL)))
    CHMAC(ch_excl_s, &kp BSPC &kp EXCL &kp SPC &sk LSHFT)
    CHMAC(ch_qmark_s, &kp BSPC &kp QMARK &kp SPC &sk LSHFT)
    CHMAC(ch_colon_s, &kp BSPC &kp COLON &kp SPC)
    CHMAC(ch_semi_s, &kp BSPC &kp SEMI &kp SPC)
    CHMAC(ch_interro_s, &kp BSPC &kp QMARK &kp SPC &sk LSHFT)
    CHMAC(ch__ing, &kp BSPC &kp I &kp N &kp G &kp SPC)
    CHMAC(ch__n_t, &kp BSPC &kp N &kp APOS &kp T &kp SPC)
    CHMAC(ch__ve, &kp BSPC &kp APOS &kp V &kp E &kp SPC)
    CHMAC(ch__re, &kp BSPC &kp APOS &kp R &kp E &kp SPC)
    CHMAC(ch__s, &kp APOS &kp S &kp SPC)
    CHMAC(ch__d, &kp APOS &kp D &kp SPC)
    CHMAC(ch__ll, &kp APOS &kp L &kp L &kp SPC)
    CHMAC(ch_the, &kp T &kp H &kp E &kp SPC)
    CHMAC(ch_S_the, &kp LS(T) &kp H &kp E &kp SPC)
    CHMAC(ch_be, &kp B &kp E &kp SPC)
    CHMAC(ch_S_be, &kp LS(B) &kp E &kp SPC)
    CHMAC(ch_of, &kp O &kp F &kp SPC)
    CHMAC(ch_S_of, &kp LS(O) &kp F &kp SPC)
    CHMAC(ch_and, &kp A &kp N &kp D &kp SPC)
    CHMAC(ch_S_and, &kp LS(A) &kp N &kp D &kp SPC)
    CHMAC(ch_a, &kp A &kp SPC)
    CHMAC(ch_S_a, &kp LS(A) &kp SPC)
    CHMAC(ch_a1, &kp LS(A) &kp SPC)
    CHMAC(ch_to, &kp T &kp O &kp SPC)
    CHMAC(ch_S_to, &kp LS(T) &kp O &kp SPC)
    CHMAC(ch_in, &kp I &kp N &kp SPC)
    CHMAC(ch_S_in, &kp LS(I) &kp N &kp SPC)
    CHMAC(ch_he, &kp H &kp E &kp SPC)
    CHMAC(ch_S_he, &kp LS(H) &kp E &kp SPC)
    CHMAC(ch_have, &kp H &kp A &kp V &kp E &kp SPC)
    CHMAC(ch_S_have, &kp LS(H) &kp A &kp V &kp E &kp SPC)
    CHMAC(ch_it, &kp I &kp T &kp SPC)
    CHMAC(ch_S_it, &kp LS(I) &kp T &kp SPC)
    CHMAC(ch_that, &kp T &kp H &kp A &kp T &kp SPC)
    CHMAC(ch_S_that, &kp LS(T) &kp H &kp A &kp T &kp SPC)
    CHMAC(ch_for, &kp F &kp O &kp R &kp SPC)
    CHMAC(ch_S_for, &kp LS(F) &kp O &kp R &kp SPC)
    CHMAC(ch_they, &kp T &kp H &kp E &kp Y &kp SPC)
    CHMAC(ch_S_they, &kp LS(T) &kp H &kp E &kp Y &kp SPC)
    CHMAC(ch_i, &kp LS(I) &kp SPC)
    CHMAC(ch_with, &kp W &kp I &kp T &kp H &kp SPC)
    CHMAC(ch_S_with, &kp LS(W) &kp I &kp T &kp H &kp SPC)
    CHMAC(ch_as, &kp A &kp S &kp SPC)
    CHMAC(ch_S_as, &kp LS(A) &kp S &kp SPC)
    CHMAC(ch_not, &kp N &kp O &kp T &kp SPC)
    CHMAC(ch_S_not, &kp LS(N) &kp O &kp T &kp SPC)
    CHMAC(ch_on, &kp O &kp N &kp SPC)
    CHMAC(ch_S_on, &kp LS(O) &kp N &kp SPC)
    CHMAC(ch_she, &kp S &kp H &kp E &kp SPC)
    CHMAC(ch_S_she, &kp LS(S) &kp H &kp E &kp SPC)
    CHMAC(ch_at, &kp A &kp T &kp SPC)
    CHMAC(ch_S_at, &kp LS(A) &kp T &kp SPC)
    CHMAC(ch_by, &kp B &kp Y &kp SPC)
    CHMAC(ch_S_by, &kp LS(B) &kp Y &kp SPC)
    CHMAC(ch_this, &kp T &kp H &kp I &kp S &kp SPC)
    CHMAC(ch_S_this, &kp LS(T) &kp H &kp I &kp S &kp SPC)
    CHMAC(ch_we, &kp W &kp E &kp SPC)
    CHMAC(ch_S_we, &kp LS(W) &kp E &kp SPC)
    CHMAC(ch_you, &kp Y &kp O &kp U &kp SPC)
    CHMAC(ch_S_you, &kp LS(Y) &kp O &kp U &kp SPC)
    CHMAC(ch_do, &kp D &kp O &kp SPC)
    CHMAC(ch_S_do, &kp LS(D) &kp O &kp SPC)
    CHMAC(ch_but, &kp B &kp U &kp T &kp SPC)
    CHMAC(ch_S_but, &kp LS(B) &kp U &kp T &kp SPC)
    CHMAC(ch_from, &kp F &kp R &kp O &kp M &kp SPC)
    CHMAC(ch_S_from, &kp LS(F) &kp R &kp O &kp M &kp SPC)
    CHMAC(ch_or, &kp O &kp R &kp SPC)
    CHMAC(ch_S_or, &kp LS(O) &kp R &kp SPC)
    CHMAC(ch_which, &kp W &kp H &kp I &kp C &kp H &kp SPC)
    CHMAC(ch_S_which, &kp LS(W) &kp H &kp I &kp C &kp H &kp SPC)
    CHMAC(ch_one, &kp O &kp N &kp E &kp SPC)
    CHMAC(ch_S_one, &kp LS(O) &kp N &kp E &kp SPC)
    CHMAC(ch_would, &kp W &kp O &kp U &kp L &kp D &kp SPC)
    CHMAC(ch_S_would, &kp LS(W) &kp O &kp U &kp L &kp D &kp SPC)
    CHMAC(ch_all, &kp A &kp L &kp L &kp SPC)
    CHMAC(ch_S_all, &kp LS(A) &kp L &kp L &kp SPC)
    CHMAC(ch_will, &kp W &kp I &kp L &kp L &kp SPC)
    CHMAC(ch_S_will, &kp LS(W) &kp I &kp L &kp L &kp SPC)
    CHMAC(ch_there, &kp T &kp H &kp E &kp R &kp E &kp SPC)
    CHMAC(ch_S_there, &kp LS(T) &kp H &kp E &kp R &kp E &kp SPC)
    CHMAC(ch_say, &kp S &kp A &kp Y &kp SPC)
    CHMAC(ch_S_say, &kp LS(S) &kp A &kp Y &kp SPC)
    CHMAC(ch_who, &kp W &kp H &kp O &kp SPC)
    CHMAC(ch_S_who, &kp LS(W) &kp H &kp O &kp SPC)
    CHMAC(ch_make, &kp M &kp A &kp K &kp E &kp SPC)
    CHMAC(ch_S_make, &kp LS(M) &kp A &kp K &kp E &kp SPC)
    CHMAC(ch_when, &kp W &kp H &kp E &kp N &kp SPC)
    CHMAC(ch_S_when, &kp LS(W) &kp H &kp E &kp N &kp SPC)
    CHMAC(ch_can, &kp C &kp A &kp N &kp SPC)
    CHMAC(ch_S_can, &kp LS(C) &kp A &kp N &kp SPC)
    CHMAC(ch_more, &kp M &kp O &kp R &kp E &kp SPC)
    CHMAC(ch_S_more, &kp LS(M) &kp O &kp R &kp E &kp SPC)
    CHMAC(ch_if, &kp I &kp F &kp SPC)
    CHMAC(ch_S_if, &kp LS(I) &kp F &kp SPC)
    CHMAC(ch_no, &kp N &kp O &kp SPC)
    CHMAC(ch_S_no, &kp LS(N) &kp O &kp SPC)
    CHMAC(ch_man, &kp M &kp A &kp N &kp SPC)
    CHMAC(ch_S_man, &kp LS(M) &kp A &kp N &kp SPC)
    CHMAC(ch_out, &kp O &kp U &kp T &kp SPC)
    CHMAC(ch_S_out, &kp LS(O) &kp U &kp T &kp SPC)
    CHMAC(ch_other, &kp O &kp T &kp H &kp E &kp R &kp SPC)
    CHMAC(ch_S_other, &kp LS(O) &kp T &kp H &kp E &kp R &kp SPC)
    CHMAC(ch_so, &kp S &kp O &kp SPC)
    CHMAC(ch_S_so, &kp LS(S) &kp O &kp SPC)
    CHMAC(ch_what, &kp W &kp H &kp A &kp T &kp SPC)
    CHMAC(ch_S_what, &kp LS(W) &kp H &kp A &kp T &kp SPC)
    CHMAC(ch_time, &kp T &kp I &kp M &kp E &kp SPC)
    CHMAC(ch_S_time, &kp LS(T) &kp I &kp M &kp E &kp SPC)
    CHMAC(ch_up, &kp U &kp P &kp SPC)
    CHMAC(ch_S_up, &kp LS(U) &kp P &kp SPC)
    CHMAC(ch_go, &kp G &kp O &kp SPC)
    CHMAC(ch_S_go, &kp LS(G) &kp O &kp SPC)
    CHMAC(ch_about, &kp A &kp B &kp O &kp U &kp T &kp SPC)
    CHMAC(ch_S_about, &kp LS(A) &kp B &kp O &kp U &kp T &kp SPC)
    CHMAC(ch_than, &kp T &kp H &kp A &kp N &kp SPC)
    CHMAC(ch_S_than, &kp LS(T) &kp H &kp A &kp N &kp SPC)
    CHMAC(ch_into, &kp I &kp N &kp T &kp O &kp SPC)
    CHMAC(ch_S_into, &kp LS(I) &kp N &kp T &kp O &kp SPC)
    CHMAC(ch_could, &kp C &kp O &kp U &kp L &kp D &kp SPC)
    CHMAC(ch_S_could, &kp LS(C) &kp O &kp U &kp L &kp D &kp SPC)
    CHMAC(ch_state, &kp S &kp T &kp A &kp T &kp E &kp SPC)
    CHMAC(ch_S_state, &kp LS(S) &kp T &kp A &kp T &kp E &kp SPC)
    CHMAC(ch_only, &kp O &kp N &kp L &kp Y &kp SPC)
    CHMAC(ch_S_only, &kp LS(O) &kp N &kp L &kp Y &kp SPC)
    CHMAC(ch_new, &kp N &kp E &kp W &kp SPC)
    CHMAC(ch_S_new, &kp LS(N) &kp E &kp W &kp SPC)
    CHMAC(ch_year, &kp Y &kp E &kp A &kp R &kp SPC)
    CHMAC(ch_S_year, &kp LS(Y) &kp E &kp A &kp R &kp SPC)
    CHMAC(ch_some, &kp S &kp O &kp M &kp E &kp SPC)
    CHMAC(ch_S_some, &kp LS(S) &kp O &kp M &kp E &kp SPC)
    CHMAC(ch_take, &kp T &kp A &kp K &kp E &kp SPC)
    CHMAC(ch_S_take, &kp LS(T) &kp A &kp K &kp E &kp SPC)
    CHMAC(ch_come, &kp C &kp O &kp M &kp E &kp SPC)
    CHMAC(ch_S_come, &kp LS(C) &kp O &kp M &kp E &kp SPC)
    CHMAC(ch_these, &kp T &kp H &kp E &kp S &kp E &kp SPC)
    CHMAC(ch_S_these, &kp LS(T) &kp H &kp E &kp S &kp E &kp SPC)
    CHMAC(ch_know, &kp K &kp N &kp O &kp W &kp SPC)
    CHMAC(ch_S_know, &kp LS(K) &kp N &kp O &kp W &kp SPC)
    CHMAC(ch_see, &kp S &kp E &kp E &kp SPC)
    CHMAC(ch_S_see, &kp LS(S) &kp E &kp E &kp SPC)
    CHMAC(ch_use, &kp U &kp S &kp E &kp SPC)
    CHMAC(ch_S_use, &kp LS(U) &kp S &kp E &kp SPC)
    CHMAC(ch_get, &kp G &kp E &kp T &kp SPC)
    CHMAC(ch_S_get, &kp LS(G) &kp E &kp T &kp SPC)
    CHMAC(ch_like, &kp L &kp I &kp K &kp E &kp SPC)
    CHMAC(ch_S_like, &kp LS(L) &kp I &kp K &kp E &kp SPC)
    CHMAC(ch_then, &kp T &kp H &kp E &kp N &kp SPC)
    CHMAC(ch_S_then, &kp LS(T) &kp H &kp E &kp N &kp SPC)
    CHMAC(ch_first, &kp F &kp I &kp R &kp S &kp T &kp SPC)
    CHMAC(ch_S_first, &kp LS(F) &kp I &kp R &kp S &kp T &kp SPC)
    CHMAC(ch_any, &kp A &kp N &kp Y &kp SPC)
    CHMAC(ch_S_any, &kp LS(A) &kp N &kp Y &kp SPC)
    CHMAC(ch_work, &kp W &kp O &kp R &kp K &kp SPC)
    CHMAC(ch_S_work, &kp LS(W) &kp O &kp R &kp K &kp SPC)
    CHMAC(ch_now, &kp N &kp O &kp W &kp SPC)
    CHMAC(ch_S_now, &kp LS(N) &kp O &kp W &kp SPC)
    CHMAC(ch_may, &kp M &kp A &kp Y &kp SPC)
    CHMAC(ch_S_may, &kp LS(M) &kp A &kp Y &kp SPC)
    CHMAC(ch_such, &kp S &kp U &kp C &kp H &kp SPC)
    CHMAC(ch_S_such, &kp LS(S) &kp U &kp C &kp H &kp SPC)
    CHMAC(ch_give, &kp G &kp I &kp V &kp E &kp SPC)
    CHMAC(ch_S_give, &kp LS(G) &kp I &kp V &kp E &kp SPC)
    CHMAC(ch_over, &kp O &kp V &kp E &kp R &kp SPC)
    CHMAC(ch_S_over, &kp LS(O) &kp V &kp E &kp R &kp SPC)
    CHMAC(ch_think, &kp T &kp H &kp I &kp N &kp K &kp SPC)
    CHMAC(ch_S_think, &kp LS(T) &kp H &kp I &kp N &kp K &kp SPC)
    CHMAC(ch_most, &kp M &kp O &kp S &kp T &kp SPC)
    CHMAC(ch_S_most, &kp LS(M) &kp O &kp S &kp T &kp SPC)
    CHMAC(ch_even, &kp E &kp V &kp E &kp N &kp SPC)
    CHMAC(ch_S_even, &kp LS(E) &kp V &kp E &kp N &kp SPC)
    CHMAC(ch_find, &kp F &kp I &kp N &kp D &kp SPC)
    CHMAC(ch_S_find, &kp LS(F) &kp I &kp N &kp D &kp SPC)
    CHMAC(ch_day, &kp D &kp A &kp Y &kp SPC)
    CHMAC(ch_S_day, &kp LS(D) &kp A &kp Y &kp SPC)
    CHMAC(ch_also, &kp A &kp L &kp S &kp O &kp SPC)
    CHMAC(ch_S_also, &kp LS(A) &kp L &kp S &kp O &kp SPC)
    CHMAC(ch_after, &kp A &kp F &kp T &kp E &kp R &kp SPC)
    CHMAC(ch_S_after, &kp LS(A) &kp F &kp T &kp E &kp R &kp SPC)
    CHMAC(ch_way, &kp W &kp A &kp Y &kp SPC)
    CHMAC(ch_S_way, &kp LS(W) &kp A &kp Y &kp SPC)
    CHMAC(ch_many, &kp M &kp A &kp N &kp Y &kp SPC)
    CHMAC(ch_S_many, &kp LS(M) &kp A &kp N &kp Y &kp SPC)
    CHMAC(ch_must, &kp M &kp U &kp S &kp T &kp SPC)
    CHMAC(ch_S_must, &kp LS(M) &kp U &kp S &kp T &kp SPC)
    CHMAC(ch_look, &kp L &kp O &kp O &kp K &kp SPC)
    CHMAC(ch_S_look, &kp LS(L) &kp O &kp O &kp K &kp SPC)
    CHMAC(ch_before, &kp B &kp E &kp F &kp O &kp R &kp E &kp SPC)
    CHMAC(ch_S_before, &kp LS(B) &kp E &kp F &kp O &kp R &kp E &kp SPC)
    CHMAC(ch_great, &kp G &kp R &kp E &kp A &kp T &kp SPC)
    CHMAC(ch_S_great, &kp LS(G) &kp R &kp E &kp A &kp T &kp SPC)
    CHMAC(ch_back, &kp B &kp A &kp C &kp K &kp SPC)
    CHMAC(ch_S_back, &kp LS(B) &kp A &kp C &kp K &kp SPC)
    CHMAC(ch_through, &kp T &kp H &kp R &kp O &kp U &kp G &kp H &kp SPC)
    CHMAC(ch_S_through, &kp LS(T) &kp H &kp R &kp O &kp U &kp G &kp H &kp SPC)
    CHMAC(ch_long, &kp L &kp O &kp N &kp G &kp SPC)
    CHMAC(ch_S_long, &kp LS(L) &kp O &kp N &kp G &kp SPC)
    CHMAC(ch_where, &kp W &kp H &kp E &kp R &kp E &kp SPC)
    CHMAC(ch_S_where, &kp LS(W) &kp H &kp E &kp R &kp E &kp SPC)
    CHMAC(ch_much, &kp M &kp U &kp C &kp H &kp SPC)
    CHMAC(ch_S_much, &kp LS(M) &kp U &kp C &kp H &kp SPC)
    CHMAC(ch_should, &kp S &kp H &kp O &kp U &kp L &kp D &kp SPC)
    CHMAC(ch_S_should, &kp LS(S) &kp H &kp O &kp U &kp L &kp D &kp SPC)
    CHMAC(ch_well, &kp W &kp E &kp L &kp L &kp SPC)
    CHMAC(ch_S_well, &kp LS(W) &kp E &kp L &kp L &kp SPC)
    CHMAC(ch_people, &kp P &kp E &kp O &kp P &kp L &kp E &kp SPC)
    CHMAC(ch_S_people, &kp LS(P) &kp E &kp O &kp P &kp L &kp E &kp SPC)
    CHMAC(ch_down, &kp D &kp O &kp W &kp N &kp SPC)
    CHMAC(ch_S_down, &kp LS(D) &kp O &kp W &kp N &kp SPC)
    CHMAC(ch_own, &kp O &kp W &kp N &kp SPC)
    CHMAC(ch_S_own, &kp LS(O) &kp W &kp N &kp SPC)
    CHMAC(ch_just, &kp J &kp U &kp S &kp T &kp SPC)
    CHMAC(ch_S_just, &kp LS(J) &kp U &kp S &kp T &kp SPC)
    CHMAC(ch_because, &kp B &kp E &kp C &kp A &kp U &kp S &kp E &kp SPC)
    CHMAC(ch_S_because, &kp LS(B) &kp E &kp C &kp A &kp U &kp S &kp E &kp SPC)
    CHMAC(ch_good, &kp G &kp O &kp O &kp D &kp SPC)
    CHMAC(ch_S_good, &kp LS(G) &kp O &kp O &kp D &kp SPC)
    CHMAC(ch_each, &kp E &kp A &kp C &kp H &kp SPC)
    CHMAC(ch_S_each, &kp LS(E) &kp A &kp C &kp H &kp SPC)
    CHMAC(ch_those, &kp T &kp H &kp O &kp S &kp E &kp SPC)
    CHMAC(ch_S_those, &kp LS(T) &kp H &kp O &kp S &kp E &kp SPC)
    CHMAC(ch_feel, &kp F &kp E &kp E &kp L &kp SPC)
    CHMAC(ch_S_feel, &kp LS(F) &kp E &kp E &kp L &kp SPC)
    CHMAC(ch_seem, &kp S &kp E &kp E &kp M &kp SPC)
    CHMAC(ch_S_seem, &kp LS(S) &kp E &kp E &kp M &kp SPC)
    CHMAC(ch_how, &kp H &kp O &kp W &kp SPC)
    CHMAC(ch_S_how, &kp LS(H) &kp O &kp W &kp SPC)
    CHMAC(ch_high, &kp H &kp I &kp G &kp H &kp SPC)
    CHMAC(ch_S_high, &kp LS(H) &kp I &kp G &kp H &kp SPC)
    CHMAC(ch_too, &kp T &kp O &kp O &kp SPC)
    CHMAC(ch_S_too, &kp LS(T) &kp O &kp O &kp SPC)
    CHMAC(ch_place, &kp P &kp L &kp A &kp C &kp E &kp SPC)
    CHMAC(ch_S_place, &kp LS(P) &kp L &kp A &kp C &kp E &kp SPC)
    CHMAC(ch_little, &kp L &kp I &kp T &kp T &kp L &kp E &kp SPC)
    CHMAC(ch_S_little, &kp LS(L) &kp I &kp T &kp T &kp L &kp E &kp SPC)
    CHMAC(ch_world, &kp W &kp O &kp R &kp L &kp D &kp SPC)
    CHMAC(ch_S_world, &kp LS(W) &kp O &kp R &kp L &kp D &kp SPC)
    CHMAC(ch_very, &kp V &kp E &kp R &kp Y &kp SPC)
    CHMAC(ch_S_very, &kp LS(V) &kp E &kp R &kp Y &kp SPC)
    CHMAC(ch_still, &kp S &kp T &kp I &kp L &kp L &kp SPC)
    CHMAC(ch_S_still, &kp LS(S) &kp T &kp I &kp L &kp L &kp SPC)
    CHMAC(ch_nation, &kp N &kp A &kp T &kp I &kp O &kp N &kp SPC)
    CHMAC(ch_S_nation, &kp LS(N) &kp A &kp T &kp I &kp O &kp N &kp SPC)
    CHMAC(ch_hand, &kp H &kp A &kp N &kp D &kp SPC)
    CHMAC(ch_S_hand, &kp LS(H) &kp A &kp N &kp D &kp SPC)
    CHMAC(ch_old, &kp O &kp L &kp D &kp SPC)
    CHMAC(ch_S_old, &kp LS(O) &kp L &kp D &kp SPC)
    CHMAC(ch_life, &kp L &kp I &kp F &kp E &kp SPC)
    CHMAC(ch_S_life, &kp LS(L) &kp I &kp F &kp E &kp SPC)
    CHMAC(ch_tell, &kp T &kp E &kp L &kp L &kp SPC)
    CHMAC(ch_S_tell, &kp LS(T) &kp E &kp L &kp L &kp SPC)
    CHMAC(ch_write, &kp W &kp R &kp I &kp T &kp E &kp SPC)
    CHMAC(ch_S_write, &kp LS(W) &kp R &kp I &kp T &kp E &kp SPC)
    CHMAC(ch_become, &kp B &kp E &kp C &kp O &kp M &kp E &kp SPC)
    CHMAC(ch_S_become, &kp LS(B) &kp E &kp C &kp O &kp M &kp E &kp SPC)
    CHMAC(ch_here, &kp H &kp E &kp R &kp E &kp SPC)
    CHMAC(ch_S_here, &kp LS(H) &kp E &kp R &kp E &kp SPC)
    CHMAC(ch_show, &kp S &kp H &kp O &kp W &kp SPC)
    CHMAC(ch_S_show, &kp LS(S) &kp H &kp O &kp W &kp SPC)
    CHMAC(ch_house, &kp H &kp O &kp U &kp S &kp E &kp SPC)
    CHMAC(ch_S_house, &kp LS(H) &kp O &kp U &kp S &kp E &kp SPC)
    CHMAC(ch_both, &kp B &kp O &kp T &kp H &kp SPC)
    CHMAC(ch_S_both, &kp LS(B) &kp O &kp T &kp H &kp SPC)
    CHMAC(ch_between, &kp B &kp E &kp T &kp W &kp E &kp E &kp N &kp SPC)
    CHMAC(ch_S_between, &kp LS(B) &kp E &kp T &kp W &kp E &kp E &kp N &kp SPC)
    CHMAC(ch_need, &kp N &kp E &kp E &kp D &kp SPC)
    CHMAC(ch_S_need, &kp LS(N) &kp E &kp E &kp D &kp SPC)
    CHMAC(ch_mean, &kp M &kp E &kp A &kp N &kp SPC)
    CHMAC(ch_S_mean, &kp LS(M) &kp E &kp A &kp N &kp SPC)
    CHMAC(ch_call, &kp C &kp A &kp L &kp L &kp SPC)
    CHMAC(ch_S_call, &kp LS(C) &kp A &kp L &kp L &kp SPC)
    CHMAC(ch_develop, &kp D &kp E &kp V &kp E &kp L &kp O &kp P &kp SPC)
    CHMAC(ch_S_develop, &kp LS(D) &kp E &kp V &kp E &kp L &kp O &kp P &kp SPC)
    CHMAC(ch_under, &kp U &kp N &kp D &kp E &kp R &kp SPC)
    CHMAC(ch_S_under, &kp LS(U) &kp N &kp D &kp E &kp R &kp SPC)
    CHMAC(ch_last, &kp L &kp A &kp S &kp T &kp SPC)
    CHMAC(ch_S_last, &kp LS(L) &kp A &kp S &kp T &kp SPC)
    CHMAC(ch_right, &kp R &kp I &kp G &kp H &kp T &kp SPC)
    CHMAC(ch_S_right, &kp LS(R) &kp I &kp G &kp H &kp T &kp SPC)
    CHMAC(ch_move, &kp M &kp O &kp V &kp E &kp SPC)
    CHMAC(ch_S_move, &kp LS(M) &kp O &kp V &kp E &kp SPC)
    CHMAC(ch_thing, &kp T &kp H &kp I &kp N &kp G &kp SPC)
    CHMAC(ch_S_thing, &kp LS(T) &kp H &kp I &kp N &kp G &kp SPC)
    CHMAC(ch_general, &kp G &kp E &kp N &kp E &kp R &kp A &kp L &kp SPC)
    CHMAC(ch_S_general, &kp LS(G) &kp E &kp N &kp E &kp R &kp A &kp L &kp SPC)
    CHMAC(ch_school, &kp S &kp C &kp H &kp O &kp O &kp L &kp SPC)
    CHMAC(ch_S_school, &kp LS(S) &kp C &kp H &kp O &kp O &kp L &kp SPC)
    CHMAC(ch_never, &kp N &kp E &kp V &kp E &kp R &kp SPC)
    CHMAC(ch_S_never, &kp LS(N) &kp E &kp V &kp E &kp R &kp SPC)
    CHMAC(ch_same, &kp S &kp A &kp M &kp E &kp SPC)
    CHMAC(ch_S_same, &kp LS(S) &kp A &kp M &kp E &kp SPC)
    CHMAC(ch_another, &kp A &kp N &kp O &kp T &kp H &kp E &kp R &kp SPC)
    CHMAC(ch_S_another, &kp LS(A) &kp N &kp O &kp T &kp H &kp E &kp R &kp SPC)
    CHMAC(ch_begin, &kp B &kp E &kp G &kp I &kp N &kp SPC)
    CHMAC(ch_S_begin, &kp LS(B) &kp E &kp G &kp I &kp N &kp SPC)
    CHMAC(ch_while, &kp W &kp H &kp I &kp L &kp E &kp SPC)
    CHMAC(ch_S_while, &kp LS(W) &kp H &kp I &kp L &kp E &kp SPC)
    CHMAC(ch_number, &kp N &kp U &kp M &kp B &kp E &kp R &kp SPC)
    CHMAC(ch_S_number, &kp LS(N) &kp U &kp M &kp B &kp E &kp R &kp SPC)
    CHMAC(ch_part, &kp P &kp A &kp R &kp T &kp SPC)
    CHMAC(ch_S_part, &kp LS(P) &kp A &kp R &kp T &kp SPC)
    CHMAC(ch_turn, &kp T &kp U &kp R &kp N &kp SPC)
    CHMAC(ch_S_turn, &kp LS(T) &kp U &kp R &kp N &kp SPC)
    CHMAC(ch_real, &kp R &kp E &kp A &kp L &kp SPC)
    CHMAC(ch_S_real, &kp LS(R) &kp E &kp A &kp L &kp SPC)
    CHMAC(ch_leave, &kp L &kp E &kp A &kp V &kp E &kp SPC)
    CHMAC(ch_S_leave, &kp LS(L) &kp E &kp A &kp V &kp E &kp SPC)
    CHMAC(ch_might, &kp M &kp I &kp G &kp H &kp T &kp SPC)
    CHMAC(ch_S_might, &kp LS(M) &kp I &kp G &kp H &kp T &kp SPC)
    CHMAC(ch_want, &kp W &kp A &kp N &kp T &kp SPC)
    CHMAC(ch_S_want, &kp LS(W) &kp A &kp N &kp T &kp SPC)
    CHMAC(ch_point, &kp P &kp O &kp I &kp N &kp T &kp SPC)
    CHMAC(ch_S_point, &kp LS(P) &kp O &kp I &kp N &kp T &kp SPC)
    CHMAC(ch_form, &kp F &kp O &kp R &kp M &kp SPC)
    CHMAC(ch_S_form, &kp LS(F) &kp O &kp R &kp M &kp SPC)
    CHMAC(ch_off, &kp O &kp F &kp F &kp SPC)
    CHMAC(ch_S_off, &kp LS(O) &kp F &kp F &kp SPC)
    CHMAC(ch_child, &kp C &kp H &kp I &kp L &kp D &kp SPC)
    CHMAC(ch_S_child, &kp LS(C) &kp H &kp I &kp L &kp D &kp SPC)
    CHMAC(ch_few, &kp F &kp E &kp W &kp SPC)
    CHMAC(ch_S_few, &kp LS(F) &kp E &kp W &kp SPC)
    CHMAC(ch_small, &kp S &kp M &kp A &kp L &kp L &kp SPC)
    CHMAC(ch_S_small, &kp LS(S) &kp M &kp A &kp L &kp L &kp SPC)
    CHMAC(ch_since, &kp S &kp I &kp N &kp C &kp E &kp SPC)
    CHMAC(ch_S_since, &kp LS(S) &kp I &kp N &kp C &kp E &kp SPC)
    CHMAC(ch_against, &kp A &kp G &kp A &kp I &kp N &kp S &kp T &kp SPC)
    CHMAC(ch_S_against, &kp LS(A) &kp G &kp A &kp I &kp N &kp S &kp T &kp SPC)
    CHMAC(ch_ask, &kp A &kp S &kp K &kp SPC)
    CHMAC(ch_S_ask, &kp LS(A) &kp S &kp K &kp SPC)
    CHMAC(ch_late, &kp L &kp A &kp T &kp E &kp SPC)
    CHMAC(ch_S_late, &kp LS(L) &kp A &kp T &kp E &kp SPC)
    CHMAC(ch_home, &kp H &kp O &kp M &kp E &kp SPC)
    CHMAC(ch_S_home, &kp LS(H) &kp O &kp M &kp E &kp SPC)
    CHMAC(ch_interes, &kp I &kp N &kp T &kp E &kp R &kp E &kp S &kp T &kp SPC)
    CHMAC(ch_S_interes, &kp LS(I) &kp N &kp T &kp E &kp R &kp E &kp S &kp T &kp SPC)
    CHMAC(ch_large, &kp L &kp A &kp R &kp G &kp E &kp SPC)
    CHMAC(ch_S_large, &kp LS(L) &kp A &kp R &kp G &kp E &kp SPC)
    CHMAC(ch_person, &kp P &kp E &kp R &kp S &kp O &kp N &kp SPC)
    CHMAC(ch_S_person, &kp LS(P) &kp E &kp R &kp S &kp O &kp N &kp SPC)
    CHMAC(ch_end, &kp E &kp N &kp D &kp SPC)
    CHMAC(ch_S_end, &kp LS(E) &kp N &kp D &kp SPC)
    CHMAC(ch_open, &kp O &kp P &kp E &kp N &kp SPC)
    CHMAC(ch_S_open, &kp LS(O) &kp P &kp E &kp N &kp SPC)
    CHMAC(ch_public, &kp P &kp U &kp B &kp L &kp I &kp C &kp SPC)
    CHMAC(ch_S_public, &kp LS(P) &kp U &kp B &kp L &kp I &kp C &kp SPC)
    CHMAC(ch_follow, &kp F &kp O &kp L &kp L &kp O &kp W &kp SPC)
    CHMAC(ch_S_follow, &kp LS(F) &kp O &kp L &kp L &kp O &kp W &kp SPC)
    CHMAC(ch_during, &kp D &kp U &kp R &kp I &kp N &kp G &kp SPC)
    CHMAC(ch_S_during, &kp LS(D) &kp U &kp R &kp I &kp N &kp G &kp SPC)
    CHMAC(ch_present, &kp P &kp R &kp E &kp S &kp E &kp N &kp T &kp SPC)
    CHMAC(ch_S_present, &kp LS(P) &kp R &kp E &kp S &kp E &kp N &kp T &kp SPC)
    CHMAC(ch_without, &kp W &kp I &kp T &kp H &kp O &kp U &kp T &kp SPC)
    CHMAC(ch_S_without, &kp LS(W) &kp I &kp T &kp H &kp O &kp U &kp T &kp SPC)
    CHMAC(ch_again, &kp A &kp G &kp A &kp I &kp N &kp SPC)
    CHMAC(ch_S_again, &kp LS(A) &kp G &kp A &kp I &kp N &kp SPC)
    CHMAC(ch_hold, &kp H &kp O &kp L &kp D &kp SPC)
    CHMAC(ch_S_hold, &kp LS(H) &kp O &kp L &kp D &kp SPC)
    CHMAC(ch_govern, &kp G &kp O &kp V &kp E &kp R &kp N &kp SPC)
    CHMAC(ch_S_govern, &kp LS(G) &kp O &kp V &kp E &kp R &kp N &kp SPC)
    CHMAC(ch_around, &kp A &kp R &kp O &kp U &kp N &kp D &kp SPC)
    CHMAC(ch_S_around, &kp LS(A) &kp R &kp O &kp U &kp N &kp D &kp SPC)
    CHMAC(ch_possibl, &kp P &kp O &kp S &kp S &kp I &kp B &kp L &kp E &kp SPC)
    CHMAC(ch_S_possibl, &kp LS(P) &kp O &kp S &kp S &kp I &kp B &kp L &kp E &kp SPC)
    CHMAC(ch_head, &kp H &kp E &kp A &kp D &kp SPC)
    CHMAC(ch_S_head, &kp LS(H) &kp E &kp A &kp D &kp SPC)
    CHMAC(ch_conside, &kp C &kp O &kp N &kp S &kp I &kp D &kp E &kp R &kp SPC)
    CHMAC(ch_S_conside, &kp LS(C) &kp O &kp N &kp S &kp I &kp D &kp E &kp R &kp SPC)
    CHMAC(ch_word, &kp W &kp O &kp R &kp D &kp SPC)
    CHMAC(ch_S_word, &kp LS(W) &kp O &kp R &kp D &kp SPC)
    CHMAC(ch_program, &kp P &kp R &kp O &kp G &kp R &kp A &kp M &kp SPC)
    CHMAC(ch_S_program, &kp LS(P) &kp R &kp O &kp G &kp R &kp A &kp M &kp SPC)
    CHMAC(ch_problem, &kp P &kp R &kp O &kp B &kp L &kp E &kp M &kp SPC)
    CHMAC(ch_S_problem, &kp LS(P) &kp R &kp O &kp B &kp L &kp E &kp M &kp SPC)
    CHMAC(ch_however, &kp H &kp O &kp W &kp E &kp V &kp E &kp R &kp SPC)
    CHMAC(ch_S_however, &kp LS(H) &kp O &kp W &kp E &kp V &kp E &kp R &kp SPC)
    CHMAC(ch_lead, &kp L &kp E &kp A &kp D &kp SPC)
    CHMAC(ch_S_lead, &kp LS(L) &kp E &kp A &kp D &kp SPC)
    CHMAC(ch_system, &kp S &kp Y &kp S &kp T &kp E &kp M &kp SPC)
    CHMAC(ch_S_system, &kp LS(S) &kp Y &kp S &kp T &kp E &kp M &kp SPC)
    CHMAC(ch_set, &kp S &kp E &kp T &kp SPC)
    CHMAC(ch_S_set, &kp LS(S) &kp E &kp T &kp SPC)
    CHMAC(ch_order, &kp O &kp R &kp D &kp E &kp R &kp SPC)
    CHMAC(ch_S_order, &kp LS(O) &kp R &kp D &kp E &kp R &kp SPC)
    CHMAC(ch_eye, &kp E &kp Y &kp E &kp SPC)
    CHMAC(ch_S_eye, &kp LS(E) &kp Y &kp E &kp SPC)
    CHMAC(ch_plan, &kp P &kp L &kp A &kp N &kp SPC)
    CHMAC(ch_S_plan, &kp LS(P) &kp L &kp A &kp N &kp SPC)
    CHMAC(ch_run, &kp R &kp U &kp N &kp SPC)
    CHMAC(ch_S_run, &kp LS(R) &kp U &kp N &kp SPC)
    CHMAC(ch_keep, &kp K &kp E &kp E &kp P &kp SPC)
    CHMAC(ch_S_keep, &kp LS(K) &kp E &kp E &kp P &kp SPC)
    CHMAC(ch_face, &kp F &kp A &kp C &kp E &kp SPC)
    CHMAC(ch_S_face, &kp LS(F) &kp A &kp C &kp E &kp SPC)
    CHMAC(ch_fact, &kp F &kp A &kp C &kp T &kp SPC)
    CHMAC(ch_S_fact, &kp LS(F) &kp A &kp C &kp T &kp SPC)
    CHMAC(ch_group, &kp G &kp R &kp O &kp U &kp P &kp SPC)
    CHMAC(ch_S_group, &kp LS(G) &kp R &kp O &kp U &kp P &kp SPC)
    CHMAC(ch_play, &kp P &kp L &kp A &kp Y &kp SPC)
    CHMAC(ch_S_play, &kp LS(P) &kp L &kp A &kp Y &kp SPC)
    CHMAC(ch_stand, &kp S &kp T &kp A &kp N &kp D &kp SPC)
    CHMAC(ch_S_stand, &kp LS(S) &kp T &kp A &kp N &kp D &kp SPC)
    CHMAC(ch_increas, &kp I &kp N &kp C &kp R &kp E &kp A &kp S &kp E &kp SPC)
    CHMAC(ch_S_increas, &kp LS(I) &kp N &kp C &kp R &kp E &kp A &kp S &kp E &kp SPC)
    CHMAC(ch_early, &kp E &kp A &kp R &kp L &kp Y &kp SPC)
    CHMAC(ch_S_early, &kp LS(E) &kp A &kp R &kp L &kp Y &kp SPC)
    CHMAC(ch_course, &kp C &kp O &kp U &kp R &kp S &kp E &kp SPC)
    CHMAC(ch_S_course, &kp LS(C) &kp O &kp U &kp R &kp S &kp E &kp SPC)
    CHMAC(ch_change, &kp C &kp H &kp A &kp N &kp G &kp E &kp SPC)
    CHMAC(ch_S_change, &kp LS(C) &kp H &kp A &kp N &kp G &kp E &kp SPC)
    CHMAC(ch_help, &kp H &kp E &kp L &kp P &kp SPC)
    CHMAC(ch_S_help, &kp LS(H) &kp E &kp L &kp P &kp SPC)
    CHMAC(ch_line, &kp L &kp I &kp N &kp E &kp SPC)
    CHMAC(ch_S_line, &kp LS(L) &kp I &kp N &kp E &kp SPC)
    CHMAC(ch_his, &kp H &kp I &kp S &kp SPC)
    CHMAC(ch_S_his, &kp LS(H) &kp I &kp S &kp SPC)
    CHMAC(ch_her, &kp H &kp E &kp R &kp SPC)
    CHMAC(ch_S_her, &kp LS(H) &kp E &kp R &kp SPC)
    CHMAC(ch_an, &kp A &kp N &kp SPC)
    CHMAC(ch_S_an, &kp LS(A) &kp N &kp SPC)
    CHMAC(ch_my, &kp M &kp Y &kp SPC)
    CHMAC(ch_S_my, &kp LS(M) &kp Y &kp SPC)
    CHMAC(ch_their, &kp T &kp H &kp E &kp I &kp R &kp SPC)
    CHMAC(ch_S_their, &kp LS(T) &kp H &kp E &kp I &kp R &kp SPC)
    CHMAC(ch_me, &kp M &kp E &kp SPC)
    CHMAC(ch_S_me, &kp LS(M) &kp E &kp SPC)
    CHMAC(ch_him, &kp H &kp I &kp M &kp SPC)
    CHMAC(ch_S_him, &kp LS(H) &kp I &kp M &kp SPC)
    CHMAC(ch_your, &kp Y &kp O &kp U &kp R &kp SPC)
    CHMAC(ch_S_your, &kp LS(Y) &kp O &kp U &kp R &kp SPC)
    CHMAC(ch_them, &kp T &kp H &kp E &kp M &kp SPC)
    CHMAC(ch_S_them, &kp LS(T) &kp H &kp E &kp M &kp SPC)
    CHMAC(ch_its, &kp I &kp T &kp S &kp SPC)
    CHMAC(ch_S_its, &kp LS(I) &kp T &kp S &kp SPC)
    CHMAC(ch_two, &kp T &kp W &kp O &kp SPC)
    CHMAC(ch_S_two, &kp LS(T) &kp W &kp O &kp SPC)
    CHMAC(ch_our, &kp O &kp U &kp R &kp SPC)
    CHMAC(ch_S_our, &kp LS(O) &kp U &kp R &kp SPC)
    CHMAC(ch_us, &kp U &kp S &kp SPC)
    CHMAC(ch_S_us, &kp LS(U) &kp S &kp SPC)
    CHMAC(ch_is, &kp I &kp S &kp SPC)
    CHMAC(ch_S_is, &kp LS(I) &kp S &kp SPC)
    CHMAC(ch_was, &kp W &kp A &kp S &kp SPC)
    CHMAC(ch_S_was, &kp LS(W) &kp A &kp S &kp SPC)
    CHMAC(ch_are, &kp A &kp R &kp E &kp SPC)
    CHMAC(ch_S_are, &kp LS(A) &kp R &kp E &kp SPC)
    CHMAC(ch_had, &kp H &kp A &kp D &kp SPC)
    CHMAC(ch_S_had, &kp LS(H) &kp A &kp D &kp SPC)
    CHMAC(ch_were, &kp W &kp E &kp R &kp E &kp SPC)
    CHMAC(ch_S_were, &kp LS(W) &kp E &kp R &kp E &kp SPC)
    CHMAC(ch_said, &kp S &kp A &kp I &kp D &kp SPC)
    CHMAC(ch_S_said, &kp LS(S) &kp A &kp I &kp D &kp SPC)
    CHMAC(ch_has, &kp H &kp A &kp S &kp SPC)
    CHMAC(ch_S_has, &kp LS(H) &kp A &kp S &kp SPC)
    CHMAC(ch_did, &kp D &kp I &kp D &kp SPC)
    CHMAC(ch_S_did, &kp LS(D) &kp I &kp D &kp SPC)
    CHMAC(ch_sound, &kp S &kp O &kp U &kp N &kp D &kp SPC)
    CHMAC(ch_S_sound, &kp LS(S) &kp O &kp U &kp N &kp D &kp SPC)
    CHMAC(ch_water, &kp W &kp A &kp T &kp E &kp R &kp SPC)
    CHMAC(ch_S_water, &kp LS(W) &kp A &kp T &kp E &kp R &kp SPC)
    CHMAC(ch_side, &kp S &kp I &kp D &kp E &kp SPC)
    CHMAC(ch_S_side, &kp LS(S) &kp I &kp D &kp E &kp SPC)
    CHMAC(ch_been, &kp B &kp E &kp E &kp N &kp SPC)
    CHMAC(ch_S_been, &kp LS(B) &kp E &kp E &kp N &kp SPC)
    CHMAC(ch_made, &kp M &kp A &kp D &kp E &kp SPC)
    CHMAC(ch_S_made, &kp LS(M) &kp A &kp D &kp E &kp SPC)
    CHMAC(ch_live, &kp L &kp I &kp V &kp E &kp SPC)
    CHMAC(ch_S_live, &kp LS(L) &kp I &kp V &kp E &kp SPC)
    CHMAC(ch_round, &kp R &kp O &kp U &kp N &kp D &kp SPC)
    CHMAC(ch_S_round, &kp LS(R) &kp O &kp U &kp N &kp D &kp SPC)
    CHMAC(ch_came, &kp C &kp A &kp M &kp E &kp SPC)
    CHMAC(ch_S_came, &kp LS(C) &kp A &kp M &kp E &kp SPC)
    CHMAC(ch_every, &kp E &kp V &kp E &kp R &kp Y &kp SPC)
    CHMAC(ch_S_every, &kp LS(E) &kp V &kp E &kp R &kp Y &kp SPC)
    CHMAC(ch_name, &kp N &kp A &kp M &kp E &kp SPC)
    CHMAC(ch_S_name, &kp LS(N) &kp A &kp M &kp E &kp SPC)
    CHMAC(ch_sentenc, &kp S &kp E &kp N &kp T &kp E &kp N &kp C &kp E &kp SPC)
    CHMAC(ch_S_sentenc, &kp LS(S) &kp E &kp N &kp T &kp E &kp N &kp C &kp E &kp SPC)
    CHMAC(ch_low, &kp L &kp O &kp W &kp SPC)
    CHMAC(ch_S_low, &kp LS(L) &kp O &kp W &kp SPC)
    CHMAC(ch_differ, &kp D &kp I &kp F &kp F &kp E &kp R &kp SPC)
    CHMAC(ch_S_differ, &kp LS(D) &kp I &kp F &kp F &kp E &kp R &kp SPC)
    CHMAC(ch_cause, &kp C &kp A &kp U &kp S &kp E &kp SPC)
    CHMAC(ch_S_cause, &kp LS(C) &kp A &kp U &kp S &kp E &kp SPC)
    CHMAC(ch_boy, &kp B &kp O &kp Y &kp SPC)
    CHMAC(ch_S_boy, &kp LS(B) &kp O &kp Y &kp SPC)
    CHMAC(ch_does, &kp D &kp O &kp E &kp S &kp SPC)
    CHMAC(ch_S_does, &kp LS(D) &kp O &kp E &kp S &kp SPC)
    CHMAC(ch_three, &kp T &kp H &kp R &kp E &kp E &kp SPC)
    CHMAC(ch_S_three, &kp LS(T) &kp H &kp R &kp E &kp E &kp SPC)
    CHMAC(ch_air, &kp A &kp I &kp R &kp SPC)
    CHMAC(ch_S_air, &kp LS(A) &kp I &kp R &kp SPC)
    CHMAC(ch_put, &kp P &kp U &kp T &kp SPC)
    CHMAC(ch_S_put, &kp LS(P) &kp U &kp T &kp SPC)
    CHMAC(ch_read, &kp R &kp E &kp A &kp D &kp SPC)
    CHMAC(ch_S_read, &kp LS(R) &kp E &kp A &kp D &kp SPC)
    CHMAC(ch_port, &kp P &kp O &kp R &kp T &kp SPC)
    CHMAC(ch_S_port, &kp LS(P) &kp O &kp R &kp T &kp SPC)
    CHMAC(ch_spell, &kp S &kp P &kp E &kp L &kp L &kp SPC)
    CHMAC(ch_S_spell, &kp LS(S) &kp P &kp E &kp L &kp L &kp SPC)
    CHMAC(ch_add, &kp A &kp D &kp D &kp SPC)
    CHMAC(ch_S_add, &kp LS(A) &kp D &kp D &kp SPC)
    CHMAC(ch_land, &kp L &kp A &kp N &kp D &kp SPC)
    CHMAC(ch_S_land, &kp LS(L) &kp A &kp N &kp D &kp SPC)
    CHMAC(ch_big, &kp B &kp I &kp G &kp SPC)
    CHMAC(ch_S_big, &kp LS(B) &kp I &kp G &kp SPC)
    CHMAC(ch_act, &kp A &kp C &kp T &kp SPC)
    CHMAC(ch_S_act, &kp LS(A) &kp C &kp T &kp SPC)
    CHMAC(ch_why, &kp W &kp H &kp Y &kp SPC)
    CHMAC(ch_S_why, &kp LS(W) &kp H &kp Y &kp SPC)
    CHMAC(ch_men, &kp M &kp E &kp N &kp SPC)
    CHMAC(ch_S_men, &kp LS(M) &kp E &kp N &kp SPC)
    CHMAC(ch_went, &kp W &kp E &kp N &kp T &kp SPC)
    CHMAC(ch_S_went, &kp LS(W) &kp E &kp N &kp T &kp SPC)
    CHMAC(ch_light, &kp L &kp I &kp G &kp H &kp T &kp SPC)
    CHMAC(ch_S_light, &kp LS(L) &kp I &kp G &kp H &kp T &kp SPC)
    CHMAC(ch_kind, &kp K &kp I &kp N &kp D &kp SPC)
    CHMAC(ch_S_kind, &kp LS(K) &kp I &kp N &kp D &kp SPC)
    CHMAC(ch_picture, &kp P &kp I &kp C &kp T &kp U &kp R &kp E &kp SPC)
    CHMAC(ch_S_picture, &kp LS(P) &kp I &kp C &kp T &kp U &kp R &kp E &kp SPC)
    CHMAC(ch_try, &kp T &kp R &kp Y &kp SPC)
    CHMAC(ch_S_try, &kp LS(T) &kp R &kp Y &kp SPC)
    CHMAC(ch_animal, &kp A &kp N &kp I &kp M &kp A &kp L &kp SPC)
    CHMAC(ch_S_animal, &kp LS(A) &kp N &kp I &kp M &kp A &kp L &kp SPC)
    CHMAC(ch_mother, &kp M &kp O &kp T &kp H &kp E &kp R &kp SPC)
    CHMAC(ch_S_mother, &kp LS(M) &kp O &kp T &kp H &kp E &kp R &kp SPC)
    CHMAC(ch_near, &kp N &kp E &kp A &kp R &kp SPC)
    CHMAC(ch_S_near, &kp LS(N) &kp E &kp A &kp R &kp SPC)
    CHMAC(ch_build, &kp B &kp U &kp I &kp L &kp D &kp SPC)
    CHMAC(ch_S_build, &kp LS(B) &kp U &kp I &kp L &kp D &kp SPC)
    CHMAC(ch_self, &kp S &kp E &kp L &kp F &kp SPC)
    CHMAC(ch_S_self, &kp LS(S) &kp E &kp L &kp F &kp SPC)
    CHMAC(ch_earth, &kp E &kp A &kp R &kp T &kp H &kp SPC)
    CHMAC(ch_S_earth, &kp LS(E) &kp A &kp R &kp T &kp H &kp SPC)
    CHMAC(ch_father, &kp F &kp A &kp T &kp H &kp E &kp R &kp SPC)
    CHMAC(ch_S_father, &kp LS(F) &kp A &kp T &kp H &kp E &kp R &kp SPC)
    CHMAC(ch_page, &kp P &kp A &kp G &kp E &kp SPC)
    CHMAC(ch_S_page, &kp LS(P) &kp A &kp G &kp E &kp SPC)
    CHMAC(ch_country, &kp C &kp O &kp U &kp N &kp T &kp R &kp Y &kp SPC)
    CHMAC(ch_S_country, &kp LS(C) &kp O &kp U &kp N &kp T &kp R &kp Y &kp SPC)
    CHMAC(ch_found, &kp F &kp O &kp U &kp N &kp D &kp SPC)
    CHMAC(ch_S_found, &kp LS(F) &kp O &kp U &kp N &kp D &kp SPC)
    CHMAC(ch_answer, &kp A &kp N &kp S &kp W &kp E &kp R &kp SPC)
    CHMAC(ch_S_answer, &kp LS(A) &kp N &kp S &kp W &kp E &kp R &kp SPC)
    CHMAC(ch_grow, &kp G &kp R &kp O &kp W &kp SPC)
    CHMAC(ch_S_grow, &kp LS(G) &kp R &kp O &kp W &kp SPC)
    CHMAC(ch_study, &kp S &kp T &kp U &kp D &kp Y &kp SPC)
    CHMAC(ch_S_study, &kp LS(S) &kp T &kp U &kp D &kp Y &kp SPC)
    CHMAC(ch_learn, &kp L &kp E &kp A &kp R &kp N &kp SPC)
    CHMAC(ch_S_learn, &kp LS(L) &kp E &kp A &kp R &kp N &kp SPC)
    CHMAC(ch_plant, &kp P &kp L &kp A &kp N &kp T &kp SPC)
    CHMAC(ch_S_plant, &kp LS(P) &kp L &kp A &kp N &kp T &kp SPC)
    CHMAC(ch_cover, &kp C &kp O &kp V &kp E &kp R &kp SPC)
    CHMAC(ch_S_cover, &kp LS(C) &kp O &kp V &kp E &kp R &kp SPC)
    CHMAC(ch_food, &kp F &kp O &kp O &kp D &kp SPC)
    CHMAC(ch_S_food, &kp LS(F) &kp O &kp O &kp D &kp SPC)
    CHMAC(ch_sun, &kp S &kp U &kp N &kp SPC)
    CHMAC(ch_S_sun, &kp LS(S) &kp U &kp N &kp SPC)
    CHMAC(ch_four, &kp F &kp O &kp U &kp R &kp SPC)
    CHMAC(ch_S_four, &kp LS(F) &kp O &kp U &kp R &kp SPC)
    CHMAC(ch_let, &kp L &kp E &kp T &kp SPC)
    CHMAC(ch_S_let, &kp LS(L) &kp E &kp T &kp SPC)
    CHMAC(ch_thought, &kp T &kp H &kp O &kp U &kp G &kp H &kp T &kp SPC)
    CHMAC(ch_S_thought, &kp LS(T) &kp H &kp O &kp U &kp G &kp H &kp T &kp SPC)
    CHMAC(ch_city, &kp C &kp I &kp T &kp Y &kp SPC)
    CHMAC(ch_S_city, &kp LS(C) &kp I &kp T &kp Y &kp SPC)
    CHMAC(ch_tree, &kp T &kp R &kp E &kp E &kp SPC)
    CHMAC(ch_S_tree, &kp LS(T) &kp R &kp E &kp E &kp SPC)
    CHMAC(ch_cross, &kp C &kp R &kp O &kp S &kp S &kp SPC)
    CHMAC(ch_S_cross, &kp LS(C) &kp R &kp O &kp S &kp S &kp SPC)
    CHMAC(ch_farm, &kp F &kp A &kp R &kp M &kp SPC)
    CHMAC(ch_S_farm, &kp LS(F) &kp A &kp R &kp M &kp SPC)
    CHMAC(ch_hard, &kp H &kp A &kp R &kp D &kp SPC)
    CHMAC(ch_S_hard, &kp LS(H) &kp A &kp R &kp D &kp SPC)
    CHMAC(ch_start, &kp S &kp T &kp A &kp R &kp T &kp SPC)
    CHMAC(ch_S_start, &kp LS(S) &kp T &kp A &kp R &kp T &kp SPC)
    CHMAC(ch_story, &kp S &kp T &kp O &kp R &kp Y &kp SPC)
    CHMAC(ch_S_story, &kp LS(S) &kp T &kp O &kp R &kp Y &kp SPC)
    CHMAC(ch_far, &kp F &kp A &kp R &kp SPC)
    CHMAC(ch_S_far, &kp LS(F) &kp A &kp R &kp SPC)
    CHMAC(ch_sea, &kp S &kp E &kp A &kp SPC)
    CHMAC(ch_S_sea, &kp LS(S) &kp E &kp A &kp SPC)
    CHMAC(ch_draw, &kp D &kp R &kp A &kp W &kp SPC)
    CHMAC(ch_S_draw, &kp LS(D) &kp R &kp A &kp W &kp SPC)
    CHMAC(ch_left, &kp L &kp E &kp F &kp T &kp SPC)
    CHMAC(ch_S_left, &kp LS(L) &kp E &kp F &kp T &kp SPC)
    CHMAC(ch_press, &kp P &kp R &kp E &kp S &kp S &kp SPC)
    CHMAC(ch_S_press, &kp LS(P) &kp R &kp E &kp S &kp S &kp SPC)
    CHMAC(ch_close, &kp C &kp L &kp O &kp S &kp E &kp SPC)
    CHMAC(ch_S_close, &kp LS(C) &kp L &kp O &kp S &kp E &kp SPC)
    CHMAC(ch_night, &kp N &kp I &kp G &kp H &kp T &kp SPC)
    CHMAC(ch_S_night, &kp LS(N) &kp I &kp G &kp H &kp T &kp SPC)
    CHMAC(ch_north, &kp N &kp O &kp R &kp T &kp H &kp SPC)
    CHMAC(ch_S_north, &kp LS(N) &kp O &kp R &kp T &kp H &kp SPC)
    CHMAC(ch_togethe, &kp T &kp O &kp G &kp E &kp T &kp H &kp E &kp R &kp SPC)
    CHMAC(ch_S_togethe, &kp LS(T) &kp O &kp G &kp E &kp T &kp H &kp E &kp R &kp SPC)
    CHMAC(ch_next, &kp N &kp E &kp X &kp T &kp SPC)
    CHMAC(ch_S_next, &kp LS(N) &kp E &kp X &kp T &kp SPC)
    CHMAC(ch_white, &kp W &kp H &kp I &kp T &kp E &kp SPC)
    CHMAC(ch_S_white, &kp LS(W) &kp H &kp I &kp T &kp E &kp SPC)
    CHMAC(ch_childre, &kp C &kp H &kp I &kp L &kp D &kp R &kp E &kp N &kp SPC)
    CHMAC(ch_S_childre, &kp LS(C) &kp H &kp I &kp L &kp D &kp R &kp E &kp N &kp SPC)
    CHMAC(ch_got, &kp G &kp O &kp T &kp SPC)
    CHMAC(ch_S_got, &kp LS(G) &kp O &kp T &kp SPC)
    CHMAC(ch_walk, &kp W &kp A &kp L &kp K &kp SPC)
    CHMAC(ch_S_walk, &kp LS(W) &kp A &kp L &kp K &kp SPC)
    CHMAC(ch_example, &kp E &kp X &kp A &kp M &kp P &kp L &kp E &kp SPC)
    CHMAC(ch_S_example, &kp LS(E) &kp X &kp A &kp M &kp P &kp L &kp E &kp SPC)
    CHMAC(ch_paper, &kp P &kp A &kp P &kp E &kp R &kp SPC)
    CHMAC(ch_S_paper, &kp LS(P) &kp A &kp P &kp E &kp R &kp SPC)
    CHMAC(ch_always, &kp A &kp L &kp W &kp A &kp Y &kp S &kp SPC)
    CHMAC(ch_S_always, &kp LS(A) &kp L &kp W &kp A &kp Y &kp S &kp SPC)
    CHMAC(ch_music, &kp M &kp U &kp S &kp I &kp C &kp SPC)
    CHMAC(ch_S_music, &kp LS(M) &kp U &kp S &kp I &kp C &kp SPC)
    CHMAC(ch_mark, &kp M &kp A &kp R &kp K &kp SPC)
    CHMAC(ch_S_mark, &kp LS(M) &kp A &kp R &kp K &kp SPC)
    CHMAC(ch_often, &kp O &kp F &kp T &kp E &kp N &kp SPC)
    CHMAC(ch_S_often, &kp LS(O) &kp F &kp T &kp E &kp N &kp SPC)
    CHMAC(ch_letter, &kp L &kp E &kp T &kp T &kp E &kp R &kp SPC)
    CHMAC(ch_S_letter, &kp LS(L) &kp E &kp T &kp T &kp E &kp R &kp SPC)
    CHMAC(ch_until, &kp U &kp N &kp T &kp I &kp L &kp SPC)
    CHMAC(ch_S_until, &kp LS(U) &kp N &kp T &kp I &kp L &kp SPC)
    CHMAC(ch_mile, &kp M &kp I &kp L &kp E &kp SPC)
    CHMAC(ch_S_mile, &kp LS(M) &kp I &kp L &kp E &kp SPC)
    CHMAC(ch_river, &kp R &kp I &kp V &kp E &kp R &kp SPC)
    CHMAC(ch_S_river, &kp LS(R) &kp I &kp V &kp E &kp R &kp SPC)
    CHMAC(ch_car, &kp C &kp A &kp R &kp SPC)
    CHMAC(ch_S_car, &kp LS(C) &kp A &kp R &kp SPC)
    CHMAC(ch_feet, &kp F &kp E &kp E &kp T &kp SPC)
    CHMAC(ch_S_feet, &kp LS(F) &kp E &kp E &kp T &kp SPC)
    CHMAC(ch_care, &kp C &kp A &kp R &kp E &kp SPC)
    CHMAC(ch_S_care, &kp LS(C) &kp A &kp R &kp E &kp SPC)
    CHMAC(ch_second, &kp S &kp E &kp C &kp O &kp N &kp D &kp SPC)
    CHMAC(ch_S_second, &kp LS(S) &kp E &kp C &kp O &kp N &kp D &kp SPC)
    CHMAC(ch_book, &kp B &kp O &kp O &kp K &kp SPC)
    CHMAC(ch_S_book, &kp LS(B) &kp O &kp O &kp K &kp SPC)
    CHMAC(ch_carry, &kp C &kp A &kp R &kp R &kp Y &kp SPC)
    CHMAC(ch_S_carry, &kp LS(C) &kp A &kp R &kp R &kp Y &kp SPC)
    CHMAC(ch_science, &kp S &kp C &kp I &kp E &kp N &kp C &kp E &kp SPC)
    CHMAC(ch_S_science, &kp LS(S) &kp C &kp I &kp E &kp N &kp C &kp E &kp SPC)
    CHMAC(ch_eat, &kp E &kp A &kp T &kp SPC)
    CHMAC(ch_S_eat, &kp LS(E) &kp A &kp T &kp SPC)
    CHMAC(ch_friend, &kp F &kp R &kp I &kp E &kp N &kp D &kp SPC)
    CHMAC(ch_S_friend, &kp LS(F) &kp R &kp I &kp E &kp N &kp D &kp SPC)
    CHMAC(ch_began, &kp B &kp E &kp G &kp A &kp N &kp SPC)
    CHMAC(ch_S_began, &kp LS(B) &kp E &kp G &kp A &kp N &kp SPC)
    CHMAC(ch_idea, &kp I &kp D &kp E &kp A &kp SPC)
    CHMAC(ch_S_idea, &kp LS(I) &kp D &kp E &kp A &kp SPC)
    CHMAC(ch_fish, &kp F &kp I &kp S &kp H &kp SPC)
    CHMAC(ch_S_fish, &kp LS(F) &kp I &kp S &kp H &kp SPC)
    CHMAC(ch_mountai, &kp M &kp O &kp U &kp N &kp T &kp A &kp I &kp N &kp SPC)
    CHMAC(ch_S_mountai, &kp LS(M) &kp O &kp U &kp N &kp T &kp A &kp I &kp N &kp SPC)
    CHMAC(ch_stop, &kp S &kp T &kp O &kp P &kp SPC)
    CHMAC(ch_S_stop, &kp LS(S) &kp T &kp O &kp P &kp SPC)
    CHMAC(ch_once, &kp O &kp N &kp C &kp E &kp SPC)
    CHMAC(ch_S_once, &kp LS(O) &kp N &kp C &kp E &kp SPC)
    CHMAC(ch_base, &kp B &kp A &kp S &kp E &kp SPC)
    CHMAC(ch_S_base, &kp LS(B) &kp A &kp S &kp E &kp SPC)
    CHMAC(ch_horse, &kp H &kp O &kp R &kp S &kp E &kp SPC)
    CHMAC(ch_S_horse, &kp LS(H) &kp O &kp R &kp S &kp E &kp SPC)
    CHMAC(ch_cut, &kp C &kp U &kp T &kp SPC)
    CHMAC(ch_S_cut, &kp LS(C) &kp U &kp T &kp SPC)
    CHMAC(ch_sure, &kp S &kp U &kp R &kp E &kp SPC)
    CHMAC(ch_S_sure, &kp LS(S) &kp U &kp R &kp E &kp SPC)
    CHMAC(ch_watch, &kp W &kp A &kp T &kp C &kp H &kp SPC)
    CHMAC(ch_S_watch, &kp LS(W) &kp A &kp T &kp C &kp H &kp SPC)
    CHMAC(ch_color, &kp C &kp O &kp L &kp O &kp R &kp SPC)
    CHMAC(ch_S_color, &kp LS(C) &kp O &kp L &kp O &kp R &kp SPC)
    CHMAC(ch_wood, &kp W &kp O &kp O &kp D &kp SPC)
    CHMAC(ch_S_wood, &kp LS(W) &kp O &kp O &kp D &kp SPC)
    CHMAC(ch_main, &kp M &kp A &kp I &kp N &kp SPC)
    CHMAC(ch_S_main, &kp LS(M) &kp A &kp I &kp N &kp SPC)
    CHMAC(ch_enough, &kp E &kp N &kp O &kp U &kp G &kp H &kp SPC)
    CHMAC(ch_S_enough, &kp LS(E) &kp N &kp O &kp U &kp G &kp H &kp SPC)
    CHMAC(ch_plain, &kp P &kp L &kp A &kp I &kp N &kp SPC)
    CHMAC(ch_S_plain, &kp LS(P) &kp L &kp A &kp I &kp N &kp SPC)
    CHMAC(ch_girl, &kp G &kp I &kp R &kp L &kp SPC)
    CHMAC(ch_S_girl, &kp LS(G) &kp I &kp R &kp L &kp SPC)
    CHMAC(ch_usual, &kp U &kp S &kp U &kp A &kp L &kp SPC)
    CHMAC(ch_S_usual, &kp LS(U) &kp S &kp U &kp A &kp L &kp SPC)
    CHMAC(ch_young, &kp Y &kp O &kp U &kp N &kp G &kp SPC)
    CHMAC(ch_S_young, &kp LS(Y) &kp O &kp U &kp N &kp G &kp SPC)
    CHMAC(ch_ready, &kp R &kp E &kp A &kp D &kp Y &kp SPC)
    CHMAC(ch_S_ready, &kp LS(R) &kp E &kp A &kp D &kp Y &kp SPC)
    CHMAC(ch_above, &kp A &kp B &kp O &kp V &kp E &kp SPC)
    CHMAC(ch_S_above, &kp LS(A) &kp B &kp O &kp V &kp E &kp SPC)
    CHMAC(ch_ever, &kp E &kp V &kp E &kp R &kp SPC)
    CHMAC(ch_S_ever, &kp LS(E) &kp V &kp E &kp R &kp SPC)
    CHMAC(ch_red, &kp R &kp E &kp D &kp SPC)
    CHMAC(ch_S_red, &kp LS(R) &kp E &kp D &kp SPC)
    CHMAC(ch_list, &kp L &kp I &kp S &kp T &kp SPC)
    CHMAC(ch_S_list, &kp LS(L) &kp I &kp S &kp T &kp SPC)
    CHMAC(ch_though, &kp T &kp H &kp O &kp U &kp G &kp H &kp SPC)
    CHMAC(ch_S_though, &kp LS(T) &kp H &kp O &kp U &kp G &kp H &kp SPC)
    CHMAC(ch_bird, &kp B &kp I &kp R &kp D &kp SPC)
    CHMAC(ch_S_bird, &kp LS(B) &kp I &kp R &kp D &kp SPC)
    CHMAC(ch_soon, &kp S &kp O &kp O &kp N &kp SPC)
    CHMAC(ch_S_soon, &kp LS(S) &kp O &kp O &kp N &kp SPC)
    CHMAC(ch_body, &kp B &kp O &kp D &kp Y &kp SPC)
    CHMAC(ch_S_body, &kp LS(B) &kp O &kp D &kp Y &kp SPC)
    CHMAC(ch_family, &kp F &kp A &kp M &kp I &kp L &kp Y &kp SPC)
    CHMAC(ch_S_family, &kp LS(F) &kp A &kp M &kp I &kp L &kp Y &kp SPC)
    CHMAC(ch_direct, &kp D &kp I &kp R &kp E &kp C &kp T &kp SPC)
    CHMAC(ch_S_direct, &kp LS(D) &kp I &kp R &kp E &kp C &kp T &kp SPC)
    CHMAC(ch_pose, &kp P &kp O &kp S &kp E &kp SPC)
    CHMAC(ch_S_pose, &kp LS(P) &kp O &kp S &kp E &kp SPC)
    CHMAC(ch_song, &kp S &kp O &kp N &kp G &kp SPC)
    CHMAC(ch_S_song, &kp LS(S) &kp O &kp N &kp G &kp SPC)
    CHMAC(ch_measure, &kp M &kp E &kp A &kp S &kp U &kp R &kp E &kp SPC)
    CHMAC(ch_S_measure, &kp LS(M) &kp E &kp A &kp S &kp U &kp R &kp E &kp SPC)
    CHMAC(ch_product, &kp P &kp R &kp O &kp D &kp U &kp C &kp T &kp SPC)
    CHMAC(ch_S_product, &kp LS(P) &kp R &kp O &kp D &kp U &kp C &kp T &kp SPC)
    CHMAC(ch_black, &kp B &kp L &kp A &kp C &kp K &kp SPC)
    CHMAC(ch_S_black, &kp LS(B) &kp L &kp A &kp C &kp K &kp SPC)
    CHMAC(ch_short, &kp S &kp H &kp O &kp R &kp T &kp SPC)
    CHMAC(ch_S_short, &kp LS(S) &kp H &kp O &kp R &kp T &kp SPC)
    CHMAC(ch_numeral, &kp N &kp U &kp M &kp E &kp R &kp A &kp L &kp SPC)
    CHMAC(ch_S_numeral, &kp LS(N) &kp U &kp M &kp E &kp R &kp A &kp L &kp SPC)
    CHMAC(ch_class, &kp C &kp L &kp A &kp S &kp S &kp SPC)
    CHMAC(ch_S_class, &kp LS(C) &kp L &kp A &kp S &kp S &kp SPC)
    CHMAC(ch_wind, &kp W &kp I &kp N &kp D &kp SPC)
    CHMAC(ch_S_wind, &kp LS(W) &kp I &kp N &kp D &kp SPC)
    CHMAC(ch_questio, &kp Q &kp U &kp E &kp S &kp T &kp I &kp O &kp N &kp SPC)
    CHMAC(ch_S_questio, &kp LS(Q) &kp U &kp E &kp S &kp T &kp I &kp O &kp N &kp SPC)
    CHMAC(ch_happen, &kp H &kp A &kp P &kp P &kp E &kp N &kp SPC)
    CHMAC(ch_S_happen, &kp LS(H) &kp A &kp P &kp P &kp E &kp N &kp SPC)
    CHMAC(ch_complet, &kp C &kp O &kp M &kp P &kp L &kp E &kp T &kp E &kp SPC)
    CHMAC(ch_S_complet, &kp LS(C) &kp O &kp M &kp P &kp L &kp E &kp T &kp E &kp SPC)
    CHMAC(ch_ship, &kp S &kp H &kp I &kp P &kp SPC)
    CHMAC(ch_S_ship, &kp LS(S) &kp H &kp I &kp P &kp SPC)
    CHMAC(ch_half, &kp H &kp A &kp L &kp F &kp SPC)
    CHMAC(ch_S_half, &kp LS(H) &kp A &kp L &kp F &kp SPC)
    CHMAC(ch_rock, &kp R &kp O &kp C &kp K &kp SPC)
    CHMAC(ch_S_rock, &kp LS(R) &kp O &kp C &kp K &kp SPC)
    CHMAC(ch_fire, &kp F &kp I &kp R &kp E &kp SPC)
    CHMAC(ch_S_fire, &kp LS(F) &kp I &kp R &kp E &kp SPC)
    CHMAC(ch_south, &kp S &kp O &kp U &kp T &kp H &kp SPC)
    CHMAC(ch_S_south, &kp LS(S) &kp O &kp U &kp T &kp H &kp SPC)
    CHMAC(ch_piece, &kp P &kp I &kp E &kp C &kp E &kp SPC)
    CHMAC(ch_S_piece, &kp LS(P) &kp I &kp E &kp C &kp E &kp SPC)
    CHMAC(ch_told, &kp T &kp O &kp L &kp D &kp SPC)
    CHMAC(ch_S_told, &kp LS(T) &kp O &kp L &kp D &kp SPC)
    CHMAC(ch_knew, &kp K &kp N &kp E &kp W &kp SPC)
    CHMAC(ch_S_knew, &kp LS(K) &kp N &kp E &kp W &kp SPC)
    CHMAC(ch_pass, &kp P &kp A &kp S &kp S &kp SPC)
    CHMAC(ch_S_pass, &kp LS(P) &kp A &kp S &kp S &kp SPC)
    CHMAC(ch_top, &kp T &kp O &kp P &kp SPC)
    CHMAC(ch_S_top, &kp LS(T) &kp O &kp P &kp SPC)
    CHMAC(ch_whole, &kp W &kp H &kp O &kp L &kp E &kp SPC)
    CHMAC(ch_S_whole, &kp LS(W) &kp H &kp O &kp L &kp E &kp SPC)
    CHMAC(ch_king, &kp K &kp I &kp N &kp G &kp SPC)
    CHMAC(ch_S_king, &kp LS(K) &kp I &kp N &kp G &kp SPC)
    CHMAC(ch_space, &kp S &kp P &kp A &kp C &kp E &kp SPC)
    CHMAC(ch_S_space, &kp LS(S) &kp P &kp A &kp C &kp E &kp SPC)
    CHMAC(ch_heard, &kp H &kp E &kp A &kp R &kp D &kp SPC)
    CHMAC(ch_S_heard, &kp LS(H) &kp E &kp A &kp R &kp D &kp SPC)
    CHMAC(ch_best, &kp B &kp E &kp S &kp T &kp SPC)
    CHMAC(ch_S_best, &kp LS(B) &kp E &kp S &kp T &kp SPC)
    CHMAC(ch_hour, &kp H &kp O &kp U &kp R &kp SPC)
    CHMAC(ch_S_hour, &kp LS(H) &kp O &kp U &kp R &kp SPC)
    CHMAC(ch_better, &kp B &kp E &kp T &kp T &kp E &kp R &kp SPC)
    CHMAC(ch_S_better, &kp LS(B) &kp E &kp T &kp T &kp E &kp R &kp SPC)
    CHMAC(ch_true, &kp T &kp R &kp U &kp E &kp SPC)
    CHMAC(ch_S_true, &kp LS(T) &kp R &kp U &kp E &kp SPC)
    CHMAC(ch_hundred, &kp H &kp U &kp N &kp D &kp R &kp E &kp D &kp SPC)
    CHMAC(ch_S_hundred, &kp LS(H) &kp U &kp N &kp D &kp R &kp E &kp D &kp SPC)
    CHMAC(ch_five, &kp F &kp I &kp V &kp E &kp SPC)
    CHMAC(ch_S_five, &kp LS(F) &kp I &kp V &kp E &kp SPC)
    CHMAC(ch_remembe, &kp R &kp E &kp M &kp E &kp M &kp B &kp E &kp R &kp SPC)
    CHMAC(ch_S_remembe, &kp LS(R) &kp E &kp M &kp E &kp M &kp B &kp E &kp R &kp SPC)
    CHMAC(ch_fast, &kp F &kp A &kp S &kp T &kp SPC)
    CHMAC(ch_S_fast, &kp LS(F) &kp A &kp S &kp T &kp SPC)
    CHMAC(ch_listen, &kp L &kp I &kp S &kp T &kp E &kp N &kp SPC)
    CHMAC(ch_S_listen, &kp LS(L) &kp I &kp S &kp T &kp E &kp N &kp SPC)
    CHMAC(ch_six, &kp S &kp I &kp X &kp SPC)
    CHMAC(ch_S_six, &kp LS(S) &kp I &kp X &kp SPC)
    CHMAC(ch_war, &kp W &kp A &kp R &kp SPC)
    CHMAC(ch_S_war, &kp LS(W) &kp A &kp R &kp SPC)
    CHMAC(ch_lay, &kp L &kp A &kp Y &kp SPC)
    CHMAC(ch_S_lay, &kp LS(L) &kp A &kp Y &kp SPC)
    CHMAC(ch_pattern, &kp P &kp A &kp T &kp T &kp E &kp R &kp N &kp SPC)
    CHMAC(ch_S_pattern, &kp LS(P) &kp A &kp T &kp T &kp E &kp R &kp N &kp SPC)
    CHMAC(ch_center, &kp C &kp E &kp N &kp T &kp E &kp R &kp SPC)
    CHMAC(ch_S_center, &kp LS(C) &kp E &kp N &kp T &kp E &kp R &kp SPC)
    CHMAC(ch_love, &kp L &kp O &kp V &kp E &kp SPC)
    CHMAC(ch_S_love, &kp LS(L) &kp O &kp V &kp E &kp SPC)
    CHMAC(ch_map, &kp M &kp A &kp P &kp SPC)
    CHMAC(ch_S_map, &kp LS(M) &kp A &kp P &kp SPC)
    CHMAC(ch_power, &kp P &kp O &kp W &kp E &kp R &kp SPC)
    CHMAC(ch_S_power, &kp LS(P) &kp O &kp W &kp E &kp R &kp SPC)
    CHMAC(ch_fly, &kp F &kp L &kp Y &kp SPC)
    CHMAC(ch_S_fly, &kp LS(F) &kp L &kp Y &kp SPC)
    CHMAC(ch_fall, &kp F &kp A &kp L &kp L &kp SPC)
    CHMAC(ch_S_fall, &kp LS(F) &kp A &kp L &kp L &kp SPC)
    CHMAC(ch_cry, &kp C &kp R &kp Y &kp SPC)
    CHMAC(ch_S_cry, &kp LS(C) &kp R &kp Y &kp SPC)
    CHMAC(ch_machine, &kp M &kp A &kp C &kp H &kp I &kp N &kp E &kp SPC)
    CHMAC(ch_S_machine, &kp LS(M) &kp A &kp C &kp H &kp I &kp N &kp E &kp SPC)
    CHMAC(ch_box, &kp B &kp O &kp X &kp SPC)
    CHMAC(ch_S_box, &kp LS(B) &kp O &kp X &kp SPC)
    CHMAC(ch_noun, &kp N &kp O &kp U &kp N &kp SPC)
    CHMAC(ch_S_noun, &kp LS(N) &kp O &kp U &kp N &kp SPC)
    CHMAC(ch_field, &kp F &kp I &kp E &kp L &kp D &kp SPC)
    CHMAC(ch_S_field, &kp LS(F) &kp I &kp E &kp L &kp D &kp SPC)
    CHMAC(ch_contain, &kp C &kp O &kp N &kp T &kp A &kp I &kp N &kp SPC)
    CHMAC(ch_S_contain, &kp LS(C) &kp O &kp N &kp T &kp A &kp I &kp N &kp SPC)
    CHMAC(ch_week, &kp W &kp E &kp E &kp K &kp SPC)
    CHMAC(ch_S_week, &kp LS(W) &kp E &kp E &kp K &kp SPC)
    CHMAC(ch_final, &kp F &kp I &kp N &kp A &kp L &kp SPC)
    CHMAC(ch_S_final, &kp LS(F) &kp I &kp N &kp A &kp L &kp SPC)
    CHMAC(ch_oh, &kp O &kp H &kp SPC)
    CHMAC(ch_S_oh, &kp LS(O) &kp H &kp SPC)
    CHMAC(ch_quick, &kp Q &kp U &kp I &kp C &kp K &kp SPC)
    CHMAC(ch_S_quick, &kp LS(Q) &kp U &kp I &kp C &kp K &kp SPC)
    CHMAC(ch_free, &kp F &kp R &kp E &kp E &kp SPC)
    CHMAC(ch_S_free, &kp LS(F) &kp R &kp E &kp E &kp SPC)
    CHMAC(ch_object, &kp O &kp B &kp J &kp E &kp C &kp T &kp SPC)
    CHMAC(ch_S_object, &kp LS(O) &kp B &kp J &kp E &kp C &kp T &kp SPC)
    CHMAC(ch_test, &kp T &kp E &kp S &kp T &kp SPC)
    CHMAC(ch_S_test, &kp LS(T) &kp E &kp S &kp T &kp SPC)
    CHMAC(ch_dry, &kp D &kp R &kp Y &kp SPC)
    CHMAC(ch_S_dry, &kp LS(D) &kp R &kp Y &kp SPC)
    CHMAC(ch_ago, &kp A &kp G &kp O &kp SPC)
    CHMAC(ch_S_ago, &kp LS(A) &kp G &kp O &kp SPC)
    CHMAC(ch_ran, &kp R &kp A &kp N &kp SPC)
    CHMAC(ch_S_ran, &kp LS(R) &kp A &kp N &kp SPC)
    CHMAC(ch_hot, &kp H &kp O &kp T &kp SPC)
    CHMAC(ch_S_hot, &kp LS(H) &kp O &kp T &kp SPC)
    CHMAC(ch_ball, &kp B &kp A &kp L &kp L &kp SPC)
    CHMAC(ch_S_ball, &kp LS(B) &kp A &kp L &kp L &kp SPC)
    CHMAC(ch_yet, &kp Y &kp E &kp T &kp SPC)
    CHMAC(ch_S_yet, &kp LS(Y) &kp E &kp T &kp SPC)
    CHMAC(ch_am, &kp A &kp M &kp SPC)
    CHMAC(ch_S_am, &kp LS(A) &kp M &kp SPC)
    CHMAC(ch_arm, &kp A &kp R &kp M &kp SPC)
    CHMAC(ch_S_arm, &kp LS(A) &kp R &kp M &kp SPC)
    CHMAC(ch_ice, &kp I &kp C &kp E &kp SPC)
    CHMAC(ch_S_ice, &kp LS(I) &kp C &kp E &kp SPC)
    CHMAC(ch_matter, &kp M &kp A &kp T &kp T &kp E &kp R &kp SPC)
    CHMAC(ch_S_matter, &kp LS(M) &kp A &kp T &kp T &kp E &kp R &kp SPC)
    CHMAC(ch_count, &kp C &kp O &kp U &kp N &kp T &kp SPC)
    CHMAC(ch_S_count, &kp LS(C) &kp O &kp U &kp N &kp T &kp SPC)
    CHMAC(ch_length, &kp L &kp E &kp N &kp G &kp T &kp H &kp SPC)
    CHMAC(ch_S_length, &kp LS(L) &kp E &kp N &kp G &kp T &kp H &kp SPC)
    CHMAC(ch_art, &kp A &kp R &kp T &kp SPC)
    CHMAC(ch_S_art, &kp LS(A) &kp R &kp T &kp SPC)
    CHMAC(ch_cell, &kp C &kp E &kp L &kp L &kp SPC)
    CHMAC(ch_S_cell, &kp LS(C) &kp E &kp L &kp L &kp SPC)
    CHMAC(ch_summer, &kp S &kp U &kp M &kp M &kp E &kp R &kp SPC)
    CHMAC(ch_S_summer, &kp LS(S) &kp U &kp M &kp M &kp E &kp R &kp SPC)
    CHMAC(ch_leg, &kp L &kp E &kp G &kp SPC)
    CHMAC(ch_S_leg, &kp LS(L) &kp E &kp G &kp SPC)
    CHMAC(ch_catch, &kp C &kp A &kp T &kp C &kp H &kp SPC)
    CHMAC(ch_S_catch, &kp LS(C) &kp A &kp T &kp C &kp H &kp SPC)
    CHMAC(ch_joy, &kp J &kp O &kp Y &kp SPC)
    CHMAC(ch_S_joy, &kp LS(J) &kp O &kp Y &kp SPC)
    CHMAC(ch_job, &kp J &kp O &kp B &kp SPC)
    CHMAC(ch_S_job, &kp LS(J) &kp O &kp B &kp SPC)
    CHMAC(ch_gas, &kp G &kp A &kp S &kp SPC)
    CHMAC(ch_S_gas, &kp LS(G) &kp A &kp S &kp SPC)
    CHMAC(ch_buy, &kp B &kp U &kp Y &kp SPC)
    CHMAC(ch_S_buy, &kp LS(B) &kp U &kp Y &kp SPC)
    CHMAC(ch_cook, &kp C &kp O &kp O &kp K &kp SPC)
    CHMAC(ch_S_cook, &kp LS(C) &kp O &kp O &kp K &kp SPC)
    CHMAC(ch_hill, &kp H &kp I &kp L &kp L &kp SPC)
    CHMAC(ch_S_hill, &kp LS(H) &kp I &kp L &kp L &kp SPC)
    CHMAC(ch_type, &kp T &kp Y &kp P &kp E &kp SPC)
    CHMAC(ch_S_type, &kp LS(T) &kp Y &kp P &kp E &kp SPC)
    CHMAC(ch_law, &kp L &kp A &kp W &kp SPC)
    CHMAC(ch_S_law, &kp LS(L) &kp A &kp W &kp SPC)
    CHMAC(ch_bit, &kp B &kp I &kp T &kp SPC)
    CHMAC(ch_S_bit, &kp LS(B) &kp I &kp T &kp SPC)
    CHMAC(ch_copy, &kp C &kp O &kp P &kp Y &kp SPC)
    CHMAC(ch_S_copy, &kp LS(C) &kp O &kp P &kp Y &kp SPC)
    CHMAC(ch_lie, &kp L &kp I &kp E &kp SPC)
    CHMAC(ch_S_lie, &kp LS(L) &kp I &kp E &kp SPC)
    CHMAC(ch_else, &kp E &kp L &kp S &kp E &kp SPC)
    CHMAC(ch_S_else, &kp LS(E) &kp L &kp S &kp E &kp SPC)
    CHMAC(ch_case, &kp C &kp A &kp S &kp E &kp SPC)
    CHMAC(ch_S_case, &kp LS(C) &kp A &kp S &kp E &kp SPC)
    CHMAC(ch_son, &kp S &kp O &kp N &kp SPC)
    CHMAC(ch_S_son, &kp LS(S) &kp O &kp N &kp SPC)
    CHMAC(ch_method, &kp M &kp E &kp T &kp H &kp O &kp D &kp SPC)
    CHMAC(ch_S_method, &kp LS(M) &kp E &kp T &kp H &kp O &kp D &kp SPC)
    CHMAC(ch_pay, &kp P &kp A &kp Y &kp SPC)
    CHMAC(ch_S_pay, &kp LS(P) &kp A &kp Y &kp SPC)
    CHMAC(ch_age, &kp A &kp G &kp E &kp SPC)
    CHMAC(ch_S_age, &kp LS(A) &kp G &kp E &kp SPC)
    CHMAC(ch_cool, &kp C &kp O &kp O &kp L &kp SPC)
    CHMAC(ch_S_cool, &kp LS(C) &kp O &kp O &kp L &kp SPC)
    CHMAC(ch_design, &kp D &kp E &kp S &kp I &kp G &kp N &kp SPC)
    CHMAC(ch_S_design, &kp LS(D) &kp E &kp S &kp I &kp G &kp N &kp SPC)
    CHMAC(ch_lot, &kp L &kp O &kp T &kp SPC)
    CHMAC(ch_S_lot, &kp LS(L) &kp O &kp T &kp SPC)
    CHMAC(ch_key, &kp K &kp E &kp Y &kp SPC)
    CHMAC(ch_S_key, &kp LS(K) &kp E &kp Y &kp SPC)
    CHMAC(ch_office, &kp O &kp F &kp F &kp I &kp C &kp E &kp SPC)
    CHMAC(ch_S_office, &kp LS(O) &kp F &kp F &kp I &kp C &kp E &kp SPC)
    CHMAC(ch_row, &kp R &kp O &kp W &kp SPC)
    CHMAC(ch_S_row, &kp LS(R) &kp O &kp W &kp SPC)
    CHMAC(ch_die, &kp D &kp I &kp E &kp SPC)
    CHMAC(ch_S_die, &kp LS(D) &kp I &kp E &kp SPC)
    CHMAC(ch_break, &kp B &kp R &kp E &kp A &kp K &kp SPC)
    CHMAC(ch_S_break, &kp LS(B) &kp R &kp E &kp A &kp K &kp SPC)
    CHMAC(ch_oil, &kp O &kp I &kp L &kp SPC)
    CHMAC(ch_S_oil, &kp LS(O) &kp I &kp L &kp SPC)
    CHMAC(ch_team, &kp T &kp E &kp A &kp M &kp SPC)
    CHMAC(ch_S_team, &kp LS(T) &kp E &kp A &kp M &kp SPC)
    CHMAC(ch_fit, &kp F &kp I &kp T &kp SPC)
    CHMAC(ch_S_fit, &kp LS(F) &kp I &kp T &kp SPC)
    CHMAC(ch_charact, &kp C &kp H &kp A &kp R &kp A &kp C &kp T &kp E &kp R &kp SPC)
    CHMAC(ch_S_charact, &kp LS(C) &kp H &kp A &kp R &kp A &kp C &kp T &kp E &kp R &kp SPC)
    CHMAC(ch_element, &kp E &kp L &kp E &kp M &kp E &kp N &kp T &kp SPC)
    CHMAC(ch_S_element, &kp LS(E) &kp L &kp E &kp M &kp E &kp N &kp T &kp SPC)
    CHMAC(ch_hit, &kp H &kp I &kp T &kp SPC)
    CHMAC(ch_S_hit, &kp LS(H) &kp I &kp T &kp SPC)
    CHMAC(ch_string, &kp S &kp T &kp R &kp I &kp N &kp G &kp SPC)
    CHMAC(ch_S_string, &kp LS(S) &kp T &kp R &kp I &kp N &kp G &kp SPC)
    CHMAC(ch_rub, &kp R &kp U &kp B &kp SPC)
    CHMAC(ch_S_rub, &kp LS(R) &kp U &kp B &kp SPC)
    CHMAC(ch_tie, &kp T &kp I &kp E &kp SPC)
    CHMAC(ch_S_tie, &kp LS(T) &kp I &kp E &kp SPC)
    CHMAC(ch_search, &kp S &kp E &kp A &kp R &kp C &kp H &kp SPC)
    CHMAC(ch_S_search, &kp LS(S) &kp E &kp A &kp R &kp C &kp H &kp SPC)
    CHMAC(ch_gun, &kp G &kp U &kp N &kp SPC)
    CHMAC(ch_S_gun, &kp LS(G) &kp U &kp N &kp SPC)
    CHMAC(ch_print, &kp P &kp R &kp I &kp N &kp T &kp SPC)
    CHMAC(ch_S_print, &kp LS(P) &kp R &kp I &kp N &kp T &kp SPC)
    CHMAC(ch_continu, &kp C &kp O &kp N &kp T &kp I &kp N &kp U &kp E &kp SPC)
    CHMAC(ch_S_continu, &kp LS(C) &kp O &kp N &kp T &kp I &kp N &kp U &kp E &kp SPC)
    CHMAC(ch_nine, &kp N &kp I &kp N &kp E &kp SPC)
    CHMAC(ch_S_nine, &kp LS(N) &kp I &kp N &kp E &kp SPC)
    CHMAC(ch_throw, &kp T &kp H &kp R &kp O &kp W &kp SPC)
    CHMAC(ch_S_throw, &kp LS(T) &kp H &kp R &kp O &kp W &kp SPC)
    CHMAC(ch_select, &kp S &kp E &kp L &kp E &kp C &kp T &kp SPC)
    CHMAC(ch_S_select, &kp LS(S) &kp E &kp L &kp E &kp C &kp T &kp SPC)
    CHMAC(ch_thank, &kp T &kp H &kp A &kp N &kp K &kp SPC)
    CHMAC(ch_S_thank, &kp LS(T) &kp H &kp A &kp N &kp K &kp SPC)
    CHMAC(ch_branch, &kp B &kp R &kp A &kp N &kp C &kp H &kp SPC)
    CHMAC(ch_S_branch, &kp LS(B) &kp R &kp A &kp N &kp C &kp H &kp SPC)
    CHMAC(ch_match, &kp M &kp A &kp T &kp C &kp H &kp SPC)
    CHMAC(ch_S_match, &kp LS(M) &kp A &kp T &kp C &kp H &kp SPC)
    CHMAC(ch_experie, &kp E &kp X &kp P &kp E &kp R &kp I &kp E &kp N &kp C &kp E &kp SPC)
    CHMAC(ch_S_experie, &kp LS(E) &kp X &kp P &kp E &kp R &kp I &kp E &kp N &kp C &kp E &kp SPC)
    CHMAC(ch_led, &kp L &kp E &kp D &kp SPC)
    CHMAC(ch_S_led, &kp LS(L) &kp E &kp D &kp SPC)
    CHMAC(ch_win, &kp W &kp I &kp N &kp SPC)
    CHMAC(ch_S_win, &kp LS(W) &kp I &kp N &kp SPC)
    CHMAC(ch_conditi, &kp C &kp O &kp N &kp D &kp I &kp T &kp I &kp O &kp N &kp SPC)
    CHMAC(ch_S_conditi, &kp LS(C) &kp O &kp N &kp D &kp I &kp T &kp I &kp O &kp N &kp SPC)
    CHMAC(ch_feed, &kp F &kp E &kp E &kp D &kp SPC)
    CHMAC(ch_S_feed, &kp LS(F) &kp E &kp E &kp D &kp SPC)
    CHMAC(ch_nor, &kp N &kp O &kp R &kp SPC)
    CHMAC(ch_S_nor, &kp LS(N) &kp O &kp R &kp SPC)
    CHMAC(ch_double, &kp D &kp O &kp U &kp B &kp L &kp E &kp SPC)
    CHMAC(ch_S_double, &kp LS(D) &kp O &kp U &kp B &kp L &kp E &kp SPC)
    CHMAC(ch_master, &kp M &kp A &kp S &kp T &kp E &kp R &kp SPC)
    CHMAC(ch_S_master, &kp LS(M) &kp A &kp S &kp T &kp E &kp R &kp SPC)
    CHMAC(ch_post, &kp P &kp O &kp S &kp T &kp SPC)
    CHMAC(ch_S_post, &kp LS(P) &kp O &kp S &kp T &kp SPC)
    CHMAC(ch_chord, &kp C &kp H &kp O &kp R &kp D &kp SPC)
    CHMAC(ch_S_chord, &kp LS(C) &kp H &kp O &kp R &kp D &kp SPC)
    CHMAC(ch_fat, &kp F &kp A &kp T &kp SPC)
    CHMAC(ch_S_fat, &kp LS(F) &kp A &kp T &kp SPC)
    CHMAC(ch_bar, &kp B &kp A &kp R &kp SPC)
    CHMAC(ch_S_bar, &kp LS(B) &kp A &kp R &kp SPC)
    CHMAC(ch_enemy, &kp E &kp N &kp E &kp M &kp Y &kp SPC)
    CHMAC(ch_S_enemy, &kp LS(E) &kp N &kp E &kp M &kp Y &kp SPC)
    CHMAC(ch_support, &kp S &kp U &kp P &kp P &kp O &kp R &kp T &kp SPC)
    CHMAC(ch_S_support, &kp LS(S) &kp U &kp P &kp P &kp O &kp R &kp T &kp SPC)
    CHMAC(ch_range, &kp R &kp A &kp N &kp G &kp E &kp SPC)
    CHMAC(ch_S_range, &kp LS(R) &kp A &kp N &kp G &kp E &kp SPC)
    CHMAC(ch_log, &kp L &kp O &kp G &kp SPC)
    CHMAC(ch_S_log, &kp LS(L) &kp O &kp G &kp SPC)
    CHMAC(ch_hey, &kp H &kp E &kp Y &kp SPC)
    CHMAC(ch_S_hey, &kp LS(H) &kp E &kp Y &kp SPC)
    CHMAC(ch_yep, &kp Y &kp E &kp P &kp SPC)
    CHMAC(ch_S_yep, &kp LS(Y) &kp E &kp P &kp SPC)
    CHMAC(ch_probabl, &kp P &kp R &kp O &kp B &kp A &kp B &kp L &kp Y &kp SPC)
    CHMAC(ch_S_probabl, &kp LS(P) &kp R &kp O &kp B &kp A &kp B &kp L &kp Y &kp SPC)
    CHMAC(ch_thanks, &kp T &kp H &kp A &kp N &kp K &kp S &kp SPC)
    CHMAC(ch_S_thanks, &kp LS(T) &kp H &kp A &kp N &kp K &kp S &kp SPC)
    CHMAC(ch_i_ve, &kp LS(I) &kp APOS &kp V &kp E &kp SPC)
    CHMAC(ch_per, &kp P &kp E &kp R &kp SPC)
    CHMAC(ch_S_per, &kp LS(P) &kp E &kp R &kp SPC)
    CHMAC(ch_acknowl, &kp A &kp C &kp K &kp N &kp O &kp W &kp L &kp E &kp D &kp G &kp E &kp SPC)
    CHMAC(ch_S_acknowl, &kp LS(A) &kp C &kp K &kp N &kp O &kp W &kp L &kp E &kp D &kp G &kp E &kp SPC)
    CHMAC(ch_attack, &kp A &kp T &kp T &kp A &kp C &kp K &kp SPC)
    CHMAC(ch_S_attack, &kp LS(A) &kp T &kp T &kp A &kp C &kp K &kp SPC)
    CHMAC(ch_defend, &kp D &kp E &kp F &kp E &kp N &kp D &kp SPC)
    CHMAC(ch_S_defend, &kp LS(D) &kp E &kp F &kp E &kp N &kp D &kp SPC)
    CHMAC(ch_expansi, &kp E &kp X &kp P &kp A &kp N &kp S &kp I &kp O &kp N &kp SPC)
    CHMAC(ch_S_expansi, &kp LS(E) &kp X &kp P &kp A &kp N &kp S &kp I &kp O &kp N &kp SPC)
    CHMAC(ch_fuck, &kp F &kp U &kp C &kp K &kp SPC)
    CHMAC(ch_S_fuck, &kp LS(F) &kp U &kp C &kp K &kp SPC)
    CHMAC(ch_hell, &kp H &kp E &kp L &kp L &kp SPC)
    CHMAC(ch_S_hell, &kp LS(H) &kp E &kp L &kp L &kp SPC)
    CHMAC(ch_heck, &kp H &kp E &kp C &kp K &kp SPC)
    CHMAC(ch_S_heck, &kp LS(H) &kp E &kp C &kp K &kp SPC)
    CHMAC(ch_shit, &kp S &kp H &kp I &kp T &kp SPC)
    CHMAC(ch_S_shit, &kp LS(S) &kp H &kp I &kp T &kp SPC)
    CHMAC(ch_persona, &kp P &kp E &kp R &kp S &kp O &kp N &kp A &kp L &kp SPC)
    CHMAC(ch_S_persona, &kp LS(P) &kp E &kp R &kp S &kp O &kp N &kp A &kp L &kp SPC)
    CHMAC(ch_i_m, &kp LS(I) &kp APOS &kp M &kp SPC)
    CHMAC(ch_i_ll, &kp LS(I) &kp APOS &kp L &kp L &kp SPC)
    CHMAC(ch_in_the, &kp I &kp N &kp SPC &kp T &kp H &kp E &kp SPC)
    CHMAC(ch_S_in_the, &kp LS(I) &kp N &kp SPC &kp T &kp H &kp E &kp SPC)
    CHMAC(ch_of_the, &kp O &kp F &kp SPC &kp T &kp H &kp E &kp SPC)
    CHMAC(ch_S_of_the, &kp LS(O) &kp F &kp SPC &kp T &kp H &kp E &kp SPC)
    CHMAC(ch_to_be, &kp T &kp O &kp SPC &kp B &kp E &kp SPC)
    CHMAC(ch_S_to_be, &kp LS(T) &kp O &kp SPC &kp B &kp E &kp SPC)
    CHMAC(ch_to_the, &kp T &kp O &kp SPC &kp T &kp H &kp E &kp SPC)
    CHMAC(ch_S_to_the, &kp LS(T) &kp O &kp SPC &kp T &kp H &kp E &kp SPC)
    CHMAC(ch_and_the, &kp A &kp N &kp D &kp SPC &kp T &kp H &kp E &kp SPC)
    CHMAC(ch_S_and_the, &kp LS(A) &kp N &kp D &kp SPC &kp T &kp H &kp E &kp SPC)
    CHMAC(ch_and_i, &kp A &kp N &kp D &kp SPC &kp LS(I) &kp SPC)
    CHMAC(ch_S_and_i, &kp LS(A) &kp N &kp D &kp SPC &kp LS(I) &kp SPC)
    CHMAC(ch_on_the, &kp O &kp N &kp SPC &kp T &kp H &kp E &kp SPC)
    CHMAC(ch_S_on_the, &kp LS(O) &kp N &kp SPC &kp T &kp H &kp E &kp SPC)
    CHMAC(ch_it_is, &kp I &kp T &kp SPC &kp I &kp S &kp SPC)
    CHMAC(ch_S_it_is, &kp LS(I) &kp T &kp SPC &kp I &kp S &kp SPC)
    CHMAC(ch_if_you, &kp I &kp F &kp SPC &kp Y &kp O &kp U &kp SPC)
    CHMAC(ch_S_if_you, &kp LS(I) &kp F &kp SPC &kp Y &kp O &kp U &kp SPC)
    CHMAC(ch_the_wor, &kp T &kp H &kp E &kp SPC &kp W &kp O &kp R &kp L &kp D &kp SPC)
    CHMAC(ch_S_the_wor, &kp LS(T) &kp H &kp E &kp SPC &kp W &kp O &kp R &kp L &kp D &kp SPC)
    CHMAC(ch_in_a, &kp I &kp N &kp SPC &kp A &kp SPC)
    CHMAC(ch_S_in_a, &kp LS(I) &kp N &kp SPC &kp A &kp SPC)
    CHMAC(ch_of_cour, &kp O &kp F &kp SPC &kp C &kp O &kp U &kp R &kp S &kp E &kp SPC)
    CHMAC(ch_S_of_cour, &kp LS(O) &kp F &kp SPC &kp C &kp O &kp U &kp R &kp S &kp E &kp SPC)
    CHMAC(ch_admin, &kp A &kp D &kp M &kp I &kp N &kp SPC)
    CHMAC(ch_S_admin, &kp LS(A) &kp D &kp M &kp I &kp N &kp SPC)
    CHMAC(ch_array, &kp A &kp R &kp R &kp A &kp Y &kp SPC)
    CHMAC(ch_S_array, &kp LS(A) &kp R &kp R &kp A &kp Y &kp SPC)
    CHMAC(ch_async, &kp A &kp S &kp Y &kp N &kp C &kp SPC)
    CHMAC(ch_S_async, &kp LS(A) &kp S &kp Y &kp N &kp C &kp SPC)
    CHMAC(ch_await, &kp A &kp W &kp A &kp I &kp T &kp SPC)
    CHMAC(ch_S_await, &kp LS(A) &kp W &kp A &kp I &kp T &kp SPC)
    CHMAC(ch_define, &kp D &kp E &kp F &kp I &kp N &kp E &kp SPC)
    CHMAC(ch_S_define, &kp LS(D) &kp E &kp F &kp I &kp N &kp E &kp SPC)
    CHMAC(ch_div, &kp D &kp I &kp V &kp SPC)
    CHMAC(ch_S_div, &kp LS(D) &kp I &kp V &kp SPC)
    CHMAC(ch_environ, &kp E &kp N &kp V &kp I &kp R &kp O &kp N &kp M &kp E &kp N &kp T &kp SPC)
    CHMAC(ch_S_environ, &kp LS(E) &kp N &kp V &kp I &kp R &kp O &kp N &kp M &kp E &kp N &kp T &kp SPC)
    CHMAC(ch_git, &kp G &kp I &kp T &kp SPC)
    CHMAC(ch_S_git, &kp LS(G) &kp I &kp T &kp SPC)
    CHMAC(ch_graphql, &kp G &kp R &kp A &kp P &kp H &kp Q &kp L &kp SPC)
    CHMAC(ch_S_graphql, &kp LS(G) &kp R &kp A &kp P &kp H &kp LS(Q) &kp LS(L) &kp SPC)
    MACRO(ch_https_, &kp H &kp T &kp T &kp P &kp S &kp COLON &kp SLASH &kp SLASH)
    CHMAC(ch_immutab, &kp I &kp M &kp M &kp U &kp T &kp A &kp B &kp L &kp E &kp SPC)
    CHMAC(ch_S_immutab, &kp LS(I) &kp M &kp M &kp U &kp T &kp A &kp B &kp L &kp E &kp SPC)
    CHMAC(ch_impleme, &kp I &kp M &kp P &kp L &kp E &kp M &kp E &kp N &kp T &kp A &kp T &kp I &kp O &kp N &kp SPC)
    CHMAC(ch_S_impleme, &kp LS(I) &kp M &kp P &kp L &kp E &kp M &kp E &kp N &kp T &kp A &kp T &kp I &kp O &kp N &kp SPC)
    CHMAC(ch_import, &kp I &kp M &kp P &kp O &kp R &kp T &kp SPC)
    CHMAC(ch_S_import, &kp LS(I) &kp M &kp P &kp O &kp R &kp T &kp SPC)
    CHMAC(ch_infra, &kp I &kp N &kp F &kp R &kp A &kp SPC)
    CHMAC(ch_S_infra, &kp LS(I) &kp N &kp F &kp R &kp A &kp SPC)
    CHMAC(ch_insert, &kp I &kp N &kp S &kp E &kp R &kp T &kp SPC)
    CHMAC(ch_S_insert, &kp LS(I) &kp N &kp S &kp E &kp R &kp T &kp SPC)
    MACRO(ch_insert_, &kp I &kp N &kp S &kp E &kp R &kp T &kp SPC &kp I &kp N &kp T &kp O &kp SPC)
    MACRO(ch_S_insert_, &kp LS(I) &kp LS(N) &kp LS(S) &kp LS(E) &kp LS(R) &kp LS(T) &kp SPC &kp LS(I) &kp LS(N) &kp LS(T) &kp LS(O) &kp SPC)
    CHMAC(ch_int, &kp I &kp N &kp T &kp SPC)
    CHMAC(ch_S_int, &kp LS(I) &kp N &kp T &kp SPC)
    CHMAC(ch_interfa, &kp I &kp N &kp T &kp E &kp R &kp F &kp A &kp C &kp E &kp SPC)
    CHMAC(ch_S_interfa, &kp LS(I) &kp N &kp T &kp E &kp R &kp F &kp A &kp C &kp E &kp SPC)
    CHMAC(ch_json, &kp J &kp S &kp O &kp N &kp SPC)
    CHMAC(ch_S_json, &kp LS(J) &kp LS(S) &kp LS(O) &kp LS(N) &kp SPC)
    CHMAC(ch_kuberne, &kp K &kp U &kp B &kp E &kp R &kp N &kp E &kp T &kp E &kp S &kp SPC)
    CHMAC(ch_S_kuberne, &kp LS(K) &kp U &kp B &kp E &kp R &kp N &kp E &kp T &kp E &kp S &kp SPC)
    CHMAC(ch_library, &kp L &kp I &kp B &kp R &kp A &kp R &kp Y &kp SPC)
    CHMAC(ch_S_library, &kp LS(L) &kp I &kp B &kp R &kp A &kp R &kp Y &kp SPC)
    CHMAC(ch_module, &kp M &kp O &kp D &kp U &kp L &kp E &kp SPC)
    CHMAC(ch_S_module, &kp LS(M) &kp O &kp D &kp U &kp L &kp E &kp SPC)
    CHMAC(ch_nil, &kp N &kp I &kp L &kp SPC)
    CHMAC(ch_S_nil, &kp LS(N) &kp I &kp L &kp SPC)
    CHMAC(ch_null, &kp N &kp U &kp L &kp L &kp SPC)
    CHMAC(ch_S_null, &kp LS(N) &kp U &kp L &kp L &kp SPC)
    CHMAC(ch_project, &kp P &kp R &kp O &kp J &kp E &kp C &kp T &kp SPC)
    CHMAC(ch_S_project, &kp LS(P) &kp R &kp O &kp J &kp E &kp C &kp T &kp SPC)
    CHMAC(ch_pub, &kp P &kp U &kp B &kp SPC)
    CHMAC(ch_S_pub, &kp LS(P) &kp U &kp B &kp SPC)
    CHMAC(ch_regex, &kp R &kp E &kp G &kp E &kp X &kp SPC)
    CHMAC(ch_S_regex, &kp LS(R) &kp E &kp G &kp E &kp X &kp SPC)
    CHMAC(ch_return, &kp R &kp E &kp T &kp U &kp R &kp N &kp SPC)
    CHMAC(ch_S_return, &kp LS(R) &kp E &kp T &kp U &kp R &kp N &kp SPC)
    CHMAC(ch_schema, &kp S &kp C &kp H &kp E &kp M &kp A &kp SPC)
    CHMAC(ch_S_schema, &kp LS(S) &kp C &kp H &kp E &kp M &kp A &kp SPC)
    MACRO(ch_select_, &kp S &kp E &kp L &kp E &kp C &kp T &kp SPC &kp ASTERISK &kp SPC &kp F &kp R &kp O &kp M &kp SPC)
    MACRO(ch_S_select_, &kp LS(S) &kp LS(E) &kp LS(L) &kp LS(E) &kp LS(C) &kp LS(T) &kp SPC &kp ASTERISK &kp SPC &kp LS(F) &kp LS(R) &kp LS(O) &kp LS(M) &kp SPC)
    CHMAC(ch_server, &kp S &kp E &kp R &kp V &kp E &kp R &kp SPC)
    CHMAC(ch_S_server, &kp LS(S) &kp E &kp R &kp V &kp E &kp R &kp SPC)
    CHMAC(ch_service, &kp S &kp E &kp R &kp V &kp I &kp C &kp E &kp SPC)
    CHMAC(ch_S_service, &kp LS(S) &kp E &kp R &kp V &kp I &kp C &kp E &kp SPC)
    CHMAC(ch_sort, &kp S &kp O &kp R &kp T &kp SPC)
    CHMAC(ch_S_sort, &kp LS(S) &kp O &kp R &kp T &kp SPC)
    CHMAC(ch_sudo, &kp S &kp U &kp D &kp O &kp SPC)
    CHMAC(ch_S_sudo, &kp LS(S) &kp U &kp D &kp O &kp SPC)
    CHMAC(ch_tempora, &kp T &kp E &kp M &kp P &kp O &kp R &kp A &kp R &kp Y &kp SPC)
    CHMAC(ch_S_tempora, &kp LS(T) &kp E &kp M &kp P &kp O &kp R &kp A &kp R &kp Y &kp SPC)
    CHMAC(ch_trait, &kp T &kp R &kp A &kp I &kp T &kp SPC)
    CHMAC(ch_S_trait, &kp LS(T) &kp R &kp A &kp I &kp T &kp SPC)
    CHMAC(ch_queue, &kp Q &kp U &kp E &kp U &kp E &kp SPC)
    CHMAC(ch_S_queue, &kp LS(Q) &kp U &kp E &kp U &kp E &kp SPC)
    CHMAC(ch_quote, &kp Q &kp U &kp O &kp T &kp E &kp SPC)
    CHMAC(ch_S_quote, &kp LS(Q) &kp U &kp O &kp T &kp E &kp SPC)
    CHMAC(ch_undefin, &kp U &kp N &kp D &kp E &kp F &kp I &kp N &kp E &kp D &kp SPC)
    CHMAC(ch_S_undefin, &kp LS(U) &kp N &kp D &kp E &kp F &kp I &kp N &kp E &kp D &kp SPC)
    CHMAC(ch__up_, &kp GRAVE &kp GRAVE &kp GRAVE &kp RETURN &kp RETURN &kp GRAVE &kp GRAVE &kp GRAVE &kp UP)
    CHMAC(ch__typesc, &kp GRAVE &kp GRAVE &kp GRAVE &kp T &kp Y &kp P &kp E &kp S &kp C &kp R &kp I &kp P &kp T &kp RETURN &kp RETURN &kp GRAVE &kp GRAVE &kp GRAVE &kp UP)
    CHMAC(ch__go_up_, &kp GRAVE &kp GRAVE &kp GRAVE &kp G &kp O &kp RETURN &kp RETURN &kp GRAVE &kp GRAVE &kp GRAVE &kp UP)
    CHMAC(ch_the_qui, &kp T &kp H &kp E &kp SPC &kp Q &kp U &kp I &kp C &kp K &kp SPC &kp B &kp R &kp O &kp W &kp N &kp SPC &kp F &kp O &kp X &kp SPC &kp J &kp U &kp M &kp P &kp S &kp SPC &kp O &kp V &kp E &kp R &kp SPC &kp T &kp H &kp E &kp SPC &kp L &kp A &kp Z &kp Y &kp SPC &kp D &kp O &kp G)
    CHMAC(ch_S_the_qui, &kp LS(T) &kp H &kp E &kp SPC &kp Q &kp U &kp I &kp C &kp K &kp SPC &kp B &kp R &kp O &kp W &kp N &kp SPC &kp F &kp O &kp X &kp SPC &kp J &kp U &kp M &kp P &kp S &kp SPC &kp O &kp V &kp E &kp R &kp SPC &kp T &kp H &kp E &kp SPC &kp L &kp A &kp Z &kp Y &kp SPC &kp D &kp O &kp G &kp DOT)
    MACRO(ch_elberet, &kp LS(E) &kp L &kp B &kp E &kp R &kp E &kp T &kp H)
    CHMAC(ch_pokemon, &kp P &kp O &kp K &kp E &kp M &kp O &kp N &kp SPC)
    CHMAC(ch_S_pokemon, &kp LS(P) &kp O &kp K &kp QMARK &kp M &kp O &kp N &kp SPC)
    CHMAC(ch_final_f, &kp F &kp I &kp N &kp A &kp L &kp SPC &kp F &kp A &kp N &kp T &kp A &kp S &kp Y &kp SPC)
    CHMAC(ch_S_final_f, &kp LS(F) &kp I &kp N &kp A &kp L &kp SPC &kp LS(F) &kp A &kp N &kp T &kp A &kp S &kp Y &kp SPC)
  };
};
